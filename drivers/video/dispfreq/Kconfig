## drivers/video/dispfreq/Kconfig
```kconfig
#
# Display Frequency configuration
#

menuconfig DISPFREQ_SUPPORT
	bool "Display Frequency support"
	help
	  Enable this to be able to choose the drivers for controlling the
	  display frequency on some platforms, for example on Smartphones.

if DISPFREQ_SUPPORT

#
# Display Frequency
#
config DISPFREQ_CLASS_DEVICE
        tristate "Lowlevel Display Frequency controls"
	help
	  This framework adds support for low-level control of the Display
	  Frequency. This includes support for refresh rate of controller

	  To have support for your specific Display controller you will have to
	  select the proper drivers which depend on this option.

if DISPFREQ_CLASS_DEVICE

config DISPFREQ_EXYNOS
	bool "Exynos Display Frequency control"
	help
	  This provides a display frequency control internal to the Exynos FIMD
	  device. If you want to use various refresh rate in Exynos display controller.
	  please use this option.

	  If in doubt, it's safe to enable this option; it doesn't kick
	  in unless the board's description says it's wired that way.

endif # DISPFREQ_CLASS_DEVICE

endif # DISPFREQ_SUPPORT
```

## drivers/video/display/Kconfig
```kconfig
menuconfig DISPLAY_CORE
	tristate "Display Core"
	---help---
	  Support common display framework for graphics devices.

if DISPLAY_CORE

config DISPLAY_PANEL_S6D6AA1
	tristate "S6D6AA1 DSI video mode panel"
	select OF_VIDEOMODE

config DISPLAY_PANEL_S6E8AA0
	tristate "S6E8AA0 DSI video mode panel"
	select OF_VIDEOMODE

config DISPLAY_PANEL_L5F31188
	tristate "L5F31188 DSI video mode panel"
	depends on OF
	select VIDEOMODE_HELPERS

config DISPLAY_SOURCE_EXYNOS_DSI
	tristate "Samsung SoC MIPI DSI Master"


endif # DISPLAY_CORE
```

## drivers/video/exynos/Kconfig
```kconfig
#
# Exynos Video configuration
#

menuconfig EXYNOS_VIDEO
	bool "Exynos Video driver support"
	help
	  This enables support for EXYNOS Video device.

if EXYNOS_VIDEO

#
# MIPI DSI driver
#

config EXYNOS_MIPI_DSI
	bool "EXYNOS MIPI DSI driver support."
	depends on ARCH_S5PV210 || ARCH_EXYNOS
	help
	  This enables support for MIPI-DSI device.

config EXYNOS_LCD_S6E8AX0
	bool "S6E8AX0 MIPI AMOLED LCD Driver"
	depends on (EXYNOS_MIPI_DSI && BACKLIGHT_CLASS_DEVICE && LCD_CLASS_DEVICE)
	default n
	help
	  If you have an S6E8AX0 MIPI AMOLED LCD Panel, say Y to enable its
	  LCD control driver.

config EXYNOS_LCD_S6E63J0X03
	bool "S6E63J0X03 MIPI AMOLED LCD Driver"
	depends on (EXYNOS_MIPI_DSI && BACKLIGHT_CLASS_DEVICE && LCD_CLASS_DEVICE)
	default n
	help
	  If you have an S6E63J0X03 MIPI AMOLED LCD Panel, say Y to enable its
	  LCD control driver.

config EXYNOS_LCD_S6E36W0X01
	bool "S6E36W0X01 MIPI AMOLED LCD Driver"
	depends on (EXYNOS_MIPI_DSI && BACKLIGHT_CLASS_DEVICE && LCD_CLASS_DEVICE)
	default n
	help
	  If you have an S6E36W0X01 MIPI AMOLED LCD Panel, say Y to enable its
	  LCD control driver.

config EXYNOS_LCD_S6E36W1X01
	bool "S6E36W1X01 MIPI AMOLED LCD Driver"
	depends on (EXYNOS_MIPI_DSI && BACKLIGHT_CLASS_DEVICE && LCD_CLASS_DEVICE)
	default n
	help
	  If you have an S6E36W1X01 MIPI AMOLED LCD Panel, say Y to enable its
	  LCD control driver.

config LCD_ESD
	bool "LCD ESD function"
	depends on EXYNOS_MIPI_DSI && BACKLIGHT_CLASS_DEVICE
	help
	  If you need a LCD ESD function to improve ESD stability,
	  Say Y to enable its ESD routine.
	  If ESD is detected, LCD will blink shortly.
	  This function depends on hardware support.

config EXYNOS_DP
	bool "EXYNOS DP driver support"
	depends on ARCH_EXYNOS
	default n
	help
	  This enables support for DP device.

config EXYNOS_SMIES
	bool "Samsung SMIES"
	depends on SOC_EXYNOS3250
	#select EXYNOS_SMIES_ENABLE_BOOTTIME

config EXYNOS_SMIES_ENABLE_BOOTTIME
	bool "Samsung SMIES Enable at Boot Time"
	depends on EXYNOS_SMIES

config EXYNOS_SMIES_RUNTIME_ACTIVE
	bool "Samsung SMIES Block Runtime Active"
	depends on (SOC_EXYNOS3250 && EXYNOS_SMIES)

config LCD_S6D6AA1
	tristate "S6D6AA1 MIPI TFT-LCD Driver"
	depends on EXYNOS_MIPI_DSI && BACKLIGHT_CLASS_DEVICE && \
	  (MACH_REDWOOD || MACH_REDWOOD45 || MACH_REDWOODLTE || MACH_REDWOOD45_LTE_JPN || MACH_REDWOOD45_LTE)
	help
	  If you have an S6D6AA1 MIPI TFT-LCD Panel, say Y to enable its
	  LCD control driver. this driver supported white maic sony ip.
	  improve power consumtion and outdoor mode using white pixel.
	  please find advantage about this driver.

config LCD_S6E8AA0
	tristate "S6E8AA0 MIPI AMOLED LCD Driver"
	depends on EXYNOS_MIPI_DSI && BACKLIGHT_CLASS_DEVICE && \
	  (MACH_SLP_MIDAS || MACH_SLP_PQ_LTE || MACH_SLP_PQ || MACH_TRATS || MACH_SLP_M3)
	help
	  If you have an S6E8AA0 MIPI AMOLED LCD Panel, say Y to enable its
	  LCD control driver.
	  If unsure, say N.
	  To compile this driver as a module, choose M here: the
	  module will be called S6E8AA0.

config LCD_S6D6FA0
	tristate "S6D6FA0 MIPI TFT-LCD Driver"
	depends on (EXYNOS_MIPI_DSI && BACKLIGHT_CLASS_DEVICE && MACH_SLP_ADONIS)
	help
	  If you have an S6D6FA0 MIPI TFT-LCD Panel,
	  say Y to enable its LCD control driver.
	  MIPI-DSI based s6d6fa0 TFT-LCD Full-HD 4.97 inch panel driver.
	  please find advantage about this driver.

config LCD_S6E8FA0
	tristate "S6E8FA0 MIPI AMOLED LCD Driver"
	depends on (EXYNOS_MIPI_DSI && BACKLIGHT_CLASS_DEVICE && MACH_SLP_ADONIS)
	help
	  If you have an S6D6FA0 MIPI AMOLED LCD Panel,
	  say Y to enable its LCD control driver.
	  MIPI-DSI based s6e8fa0 AMOLED LCD Full-HD panel driver.
	  please find advantage about this driver.

config LCD_L5F31188
	tristate "L5F31188 MIPI TFT-LCD Driver"
	depends on EXYNOS_MIPI_DSI && BACKLIGHT_CLASS_DEVICE && \
	  (MACH_REDWOOD || MACH_REDWOOD45 || MACH_REDWOODLTE || MACH_REDWOOD45_LTE_JPN || MACH_REDWOOD45_LTE)
	help
	  If you have an L5F31188 MIPI TFT-LCD Panel,
	  say Y to enable its LCD control driver.
	  MIPI-DSI based L5F31188 TFT-LCD HD 4.5 inch panel driver.
	  please find advantage about this driver.

config LCD_ESD
	bool "LCD ESD function"
	depends on EXYNOS_MIPI_DSI && BACKLIGHT_CLASS_DEVICE
	help
	  If you need a LCD ESD function to improve ESD stability,
	  Say Y to enable its ESD routine.
	  If ESD is detected, LCD will blink shortly.
	  This function depends on hardware support.

config BL_OVERHEATING_PROTECTION
	tristate "Backlight driver feature for Intelligent Overheating Protection"
	depends on BACKLIGHT_CLASS_DEVICE
	help
	  If you want to control the backlight under overheating condition,
	  Say Y to enable the Intelligent Overheating Protection Feature.

	  If unsure, say N.

	  To compile this driver as a module, choose M here.

config BACKLIGHT_SMART_DIMMING
	bool "SLP Backlight driver feature for smart dimming"
	depends on (MACH_SLP_MIDAS || MACH_SLP_T0_LTE || MACH_SLP_PQ_LTE || \
	  MACH_SLP_PQ || MACH_TRATS || MACH_SLP_ADONIS || MACH_SLP_M3)
	help
	  If you have an AMOLED display device
	  And it support a smart dimming,
	  Say Y to enable the Smart Dimming Feature.
	  Please find advantage about this driver.

config FIMD_EXT_SUPPORT
	bool "FIMD Extension Driver support"
	depends on SLP
	default n

if FIMD_EXT_SUPPORT

config MDNIE_SUPPORT
	bool "Samsung SoC mDNIe support"
	depends on FIMD_EXT_SUPPORT
	help
	  If you have a mDNIe device, say Y to enable its
	  mDNIe support. Enabling the mDNIe driver,
	  please consider fimd lite driver enable.

	  If unsure, say N.

config MDNIE_PWM_SUPPORT
	bool "mDNIe Backlight Driver"
	depends on MDNIE_SUPPORT
	default n
	help
	  If you have a mDNIe device, say y to
	  enable the PWM for backlight driver.

config FIMD_LITE_SUPPORT
	bool "Samsung SoC FIMD-LITE support"
	depends on FIMD_EXT_SUPPORT

endif # FIMD_EXT_SUPPORT

endif # EXYNOS_VIDEO
```

## drivers/video/fbdev/exynos/Kconfig
```kconfig
if SOC_EXYNOS9110

source "drivers/video/fbdev/exynos/dpu_9110/Kconfig"

endif # SOC_EXYNOS9110
```

## drivers/video/omap2/displays/Kconfig
```kconfig
menu "OMAP2/3 Display Device Drivers"
        depends on OMAP2_DSS

config PANEL_GENERIC
        tristate "Generic Panel"
        help
	  Generic panel driver.
	  Used for DVI output for Beagle and OMAP3 SDP.

config PANEL_SAMSUNG_LTE430WQ_F0C
        tristate "Samsung LTE430WQ-F0C LCD Panel"
        depends on OMAP2_DSS
        help
          LCD Panel used on Overo Palo43

config PANEL_SHARP_LS037V7DW01
        tristate "Sharp LS037V7DW01 LCD Panel"
        depends on OMAP2_DSS
        help
          LCD Panel used in TI's SDP3430 and EVM boards

config PANEL_PICO_DLP
	tristate "OMAP PICO DLP Panel"
	depends on OMAP2_DSS
	help
	LCD Panel used in TI's SDP4430 and EVM boards

config PANEL_TAAL
        tristate "Taal DSI Panel"
        depends on OMAP2_DSS_DSI
        help
          Taal DSI command mode panel from TPO.

config PANEL_SHOLES
        tristate "Sholes Panel"
        help
	  LCD Panel used in sholes

config LCD_4430SDP
        tristate "OMAP4 LCD Panel"
        help
          LCD Panel used in OMAP4

config PANEL_4430SDP_TAAL
	tristate "OMAP4 LCD TAAL Panel"
	help
		DSI LCD Panel used in OMAP4

config PANEL_NEC
	tristate "NEC Panel"
	help
		LCD Panel used in the Zoom board

config PANEL_AMS
        tristate "AMS Panel"
        help
                LCD Panel used in the Archer board

config PANEL_SHARP_S6D16A
        tristate "SHARP S6D16A Panel for Latona Emul"
        help
                LCD Panel used in the Latona Emul board

config PANEL_HYDIS
        tristate "HYDIS WVGA Panel for Latona"
        help
                LCD Panel used in the Latona board

config CHN_LCD_PANEL_SHARP_S6D05A
        tristate "SHARP S6D05A Panel for Heron"
        help
                LCD Panel used in the Heron board
endmenu
```

## kernel/swap/Kconfig
```kconfig
#
# General SWAP options
#

menuconfig SWAP_DA
	bool "System Wide Analysis of Performance"
	select KALLSYMS
	select DEBUG_FS
	help
	  SWAP is a profiling tool.

	  If unsure, say Y.

if SWAP_DA

config SWAP_KERNEL_IMMUTABLE
	bool "SWAP cannot modify kernel"

config SWAP_HOOK_TASKDATA
	bool "SWAP TD hooks"

config SWAP_HOOK_USAUX
	bool "SWAP US hooks"
	depends on ARM64
	select SWAP_HOOK_TASKDATA

config SWAP_HOOK_SYSCALL
	bool "SWAP syscall hooks"
	depends on ARM64

config SWAP_HOOK_SWITCH_TO
	bool "SWAP context hooks"

config SWAP_HOOK_ENERGY
	bool "SWAP energy estimation hooks"

config SWAP_HOOK_FILE_OPS
	bool "SWAP file operations hooks"

config SWAP_HOOK_SIGNAL
	bool "SWAP signal hooks"

endif # SWAP_DA
```

## samsung/yas530/Kconfig
```kconfig
config INPUT_YAS_MAGNETOMETER
         tristate "YAS Geomagnetic Sensor"
         depends on I2C
	default n
	help
		Say Y to enable YAS geomagnetic support.

config INPUT_YAS_MAGNETOMETER_POSITION
         int "YAS Geomagnetic Sensor Mounting Position on Board"
         depends on INPUT_YAS_MAGNETOMETER
         default "0"
         help
           Chip mounting position (pin 1).
              0: top, upper-left
              1: top, upper-right
              2: top, lower-right
              3: top, lower-left
              4: bottom, upper-left
              5: bottom, upper-right
              6: bottom, lower-right
              7: bottom, lower-left

config INPUT_YAS_MAGNETOMETER_USE_GPIO_I2C
	tristate "YAS Geomagnetic Sensor I2C Policy"
	default n
	help
		Say Y to use I2C using GPIO
```

## sound/soc/codecs/ymu831/Kconfig
```kconfig
config SND_SOC_YAMAHA_YMU831
	tristate "YAMAHA_YMU831 Codec - SPI"
	depends on SND_SOC && SPI_MASTER
	select SND_HWDEP

config SND_SOC_YAMAHA_YMU831_DEBUG
	bool "YAMAHA_YMU831 verbose debug messages while core driver call"
	select SND_DEBUG
	depends on SND_SOC_YAMAHA_YMU831
```

## sound/soc/samsung/vts/Kconfig
```kconfig
config SND_SOC_SAMSUNG_VTS
	bool "Samsung VTS"
	select SND_SOC_SAMSUNG_MAILBOX
	help
	  Say Y if you want to use voice trigger system.

config SND_SOC_SAMSUNG_MAILBOX
	bool "Samsung MAILBOX"
	depends on SND_SOC_SAMSUNG_VTS
	select GENERIC_IRQ_CHIP
	help
	  Say Y if you want to use mailbox for voice trigger system.
```
