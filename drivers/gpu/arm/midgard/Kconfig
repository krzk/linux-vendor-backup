## drivers/thermal/samsung/Kconfig
```kconfig
config EXYNOS_THERMAL
	tristate "Exynos thermal management unit driver"
	depends on ARCH_HAS_BANDGAP && OF
	help
	  If you say yes here you get support for the TMU (Thermal Management
	  Unit) driver for SAMSUNG EXYNOS series of SoCs. This driver initialises
	  the TMU, reports temperature and handles cooling action if defined.
	  This driver uses the Exynos core thermal APIs, TMU configuration data
	  from the supported SoCs, common registration/unregistration functions
	  to the core thermal layer and also the generic CPU cooling APIs.
```

## drivers/trace/Kconfig
```kconfig
#
# Trace(debugging) driver configuration
#

config EXYNOS_SNAPSHOT
	bool "Exynos SnapShot(ESS) support for debugging"
	default n
	depends on ARCH_EXYNOS
	help
	  Say Y here if you want to enable Exynos SnapShot (ESS)
	  support for debuuging.

config EXYNOS_SNAPSHOT_CALLSTACK
	int "shown callstack level"
	depends on EXYNOS_SNAPSHOT
	default 4
	help
	  If you are using ESS and want to set level of callstack
	  shown in ESS, then set the level.
```
