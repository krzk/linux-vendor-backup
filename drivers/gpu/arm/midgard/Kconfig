## drivers/usb/gadget/Kconfig
```kconfig
#
# USB Gadget support on a system involves
#    (a) a peripheral controller, and
#    (b) the gadget driver using it.
#
# NOTE:  Gadget support ** DOES NOT ** depend on host-side CONFIG_USB !!
#
#  - Host systems (like PCs) need CONFIG_USB (with "A" jacks).
#  - Peripherals (like PDAs) need CONFIG_USB_GADGET (with "B" jacks).
#  - Some systems have both kinds of controllers.
#
# With help from a special transceiver and a "Mini-AB" jack, systems with
# both kinds of controller can also support "USB On-the-Go" (CONFIG_USB_OTG).
#

menuconfig USB_GADGET
	tristate "USB Gadget Support"
	select NLS
	help
	   USB is a master/slave protocol, organized with one master
	   host (such as a PC) controlling up to 127 peripheral devices.
	   The USB hardware is asymmetric, which makes it easier to set up:
	   you can't connect a "to-the-host" connector to a peripheral.

	   Linux can run in the host, or in the peripheral.  In both cases
	   you need a low level bus controller driver, and some software
	   talking to it.  Peripheral controllers are often discrete silicon,
	   or are integrated with the CPU in a microcontroller.  The more
	   familiar host side controllers have names like "EHCI", "OHCI",
	   or "UHCI", and are usually integrated into southbridges on PC
	   motherboards.

	   Enable this configuration option if you want to run Linux inside
	   a USB peripheral device.  Configure one hardware driver for your
	   peripheral/device side bus controller, and a "gadget driver" for
	   your peripheral protocol.  (If you use modular gadget drivers,
	   you may configure more than one.)

	   If in doubt, say "N" and don't enable these drivers; most people
	   don't have this kind of hardware (except maybe inside Linux PDAs).

	   For more information, see <http://www.linux-usb.org/gadget> and
	   the kernel DocBook documentation for this API.

if USB_GADGET

config USB_GADGET_DEBUG
	bool "Debugging messages (DEVELOPMENT)"
	depends on DEBUG_KERNEL
	help
	   Many controller and gadget drivers will print some debugging
	   messages if you use this option to ask for those messages.

	   Avoid enabling these messages, even if you're actively
	   debugging such a driver.  Many drivers will emit so many
	   messages that the driver timings are affected, which will
	   either create new failure modes or remove the one you're
	   trying to track down.  Never enable these messages for a
	   production build.

config USB_GADGET_VERBOSE
	bool "Verbose debugging Messages (DEVELOPMENT)"
	depends on USB_GADGET_DEBUG
	help
	   Many controller and gadget drivers will print verbose debugging
	   messages if you use this option to ask for those messages.

	   Avoid enabling these messages, even if you're actively
	   debugging such a driver.  Many drivers will emit so many
	   messages that the driver timings are affected, which will
	   either create new failure modes or remove the one you're
	   trying to track down.  Never enable these messages for a
	   production build.

config USB_GADGET_DEBUG_FILES
	bool "Debugging information files (DEVELOPMENT)"
	depends on PROC_FS
	help
	   Some of the drivers in the "gadget" framework can expose
	   debugging information in files such as /proc/driver/udc
	   (for a peripheral controller).  The information in these
	   files may help when you're troubleshooting or bringing up a
	   driver on a new board.   Enable these files by choosing "Y"
	   here.  If in doubt, or to conserve kernel memory, say "N".

config USB_GADGET_DEBUG_FS
	bool "Debugging information files in debugfs (DEVELOPMENT)"
	depends on DEBUG_FS
	help
	   Some of the drivers in the "gadget" framework can expose
	   debugging information in files under /sys/kernel/debug/.
	   The information in these files may help when you're
	   troubleshooting or bringing up a driver on a new board.
	   Enable these files by choosing "Y" here.  If in doubt, or
	   to conserve kernel memory, say "N".

config USB_GADGET_VBUS_DRAW
	int "Maximum VBUS Power usage (2-500 mA)"
	range 2 500
	default 2
	help
	   Some devices need to draw power from USB when they are
	   configured, perhaps to operate circuitry or to recharge
	   batteries.  This is in addition to any local power supply,
	   such as an AC adapter or batteries.

	   Enter the maximum power your device draws through USB, in
	   milliAmperes.  The permitted range of values is 2 - 500 mA;
	   0 mA would be legal, but can make some hosts misbehave.

	   This value will be used except for system-specific gadget
	   drivers that have more specific information.

config USB_GADGET_STORAGE_NUM_BUFFERS
	int "Number of storage pipeline buffers"
	range 2 4
	default 2
	help
	   Usually 2 buffers are enough to establish a good buffering
	   pipeline. The number may be increased in order to compensate
	   for a bursty VFS behaviour. For instance there may be CPU wake up
	   latencies that makes the VFS to appear bursty in a system with
	   an CPU on-demand governor. Especially if DMA is doing IO to
	   offload the CPU. In this case the CPU will go into power
	   save often and spin up occasionally to move data within VFS.
	   If selecting USB_GADGET_DEBUG_FILES this value may be set by
	   a module parameter as well.
	   If unsure, say 2.

source "drivers/usb/gadget/udc/Kconfig"

#
# USB Gadget Drivers
#

# composite based drivers
config USB_LIBCOMPOSITE
	tristate "USB Gadget Drivers"
	select CONFIGFS_FS
	depends on USB_GADGET

config USB_F_ACM
	tristate

# Just a dummy config which indicates that serial gadget requires ACM in particular state
config USB_G_SERIAL_REQ_F_ACM
       tristate

# Just a dummy config which indicates that cdc gadget requires ACM in particular state
config USB_G_CDC_COMPOSITE_REQ_F_ACM
       tristate

# Just a dummy config which indicates that nokia gadget requires ACM in particular state
config USB_G_NOKIA_REQ_F_ACM
       tristate

# Just a dummy config which indicates that acm ms gadget requires ACM in particular state
config USB_G_ACM_MS_REQ_F_ACM
       tristate

# Just a dummy config which indicates that gadget multi requires ACM in particular state
config USB_G_MULTI_REQ_F_ACM
       tristate

# Just a dummy config which indicates that slp gadget requires ACM in particular state
config USB_G_SLP_REQ_F_ACM
       tristate

if USB_CONFIGFS_F_ACM = y || USB_G_SERIAL_REQ_F_ACM = y || USB_G_CDC_COMPOSITE_REQ_F_ACM = y || USB_G_NOKIA_REQ_F_ACM = y || USB_G_ACM_MS_REQ_F_ACM = y || USB_G_MULTI_REQ_F_ACM = y || USB_G_SLP_REQ_F_ACM = y
config USB_F_ACM_SELECTOR
       tristate
       default y
       select USB_F_ACM
       select USB_F_ACM_REQ_U_SERIAL
endif

if !(USB_CONFIGFS_F_ACM = y || USB_G_SERIAL_REQ_F_ACM = y || USB_G_CDC_COMPOSITE_REQ_F_ACM = y || USB_G_NOKIA_REQ_F_ACM = y || USB_G_ACM_MS_REQ_F_ACM = y || USB_G_MULTI_REQ_F_ACM = y || USB_G_SLP_REQ_F_ACM = y) && (USB_CONFIGFS_F_ACM = m || USB_G_SERIAL_REQ_F_ACM = m || USB_G_CDC_COMPOSITE_REQ_F_ACM = m || USB_G_NOKIA_REQ_F_ACM = m || USB_G_ACM_MS_REQ_F_ACM = m || USB_G_MULTI_REQ_F_ACM = m || USB_G_SLP_REQ_F_ACM = m)
config USB_F_ACM_SELECTOR
       tristate
       default m
       select USB_F_ACM
       select USB_F_ACM_REQ_U_SERIAL
endif

config USB_F_SS_LB
	tristate

# Just a dummy config which indicates that gadget zero requires SS and LB in particular state
config USB_G_ZERO_REQ_F_SS_LB
       tristate

if USB_CONFIGFS_F_SS_LB = y || USB_G_ZERO_REQ_F_SS_LB = y
config USB_F_SS_LB_SELECTOR
       tristate
       default y
       select USB_F_SS_LB
endif

if !(USB_CONFIGFS_F_SS_LB = y || USB_G_ZERO_REQ_F_SS_LB = y) && (USB_CONFIGFS_F_SS_LB = m || USB_G_ZERO_REQ_F_SS_LB = m)
config USB_F_SS_LB_SELECTOR
       tristate
       default m
       select USB_F_SS_LB
endif

config USB_U_SERIAL
	tristate

# Just a dummy config which indicates that F_ACM requires U_SERIAL in particular state
config USB_F_ACM_REQ_U_SERIAL
       tristate

# Just a dummy config which indicates that F_SERIAL requires U_SERIAL in particular state
config USB_F_SERIAL_REQ_U_SERIAL
       tristate

# Just a dummy config which indicates that F_OBEX requires U_SERIAL in particular state
config USB_F_OBEX_REQ_U_SERIAL
       tristate

# Just a dummy config which indicates that dbg gadget requires U_SERIAL in particular state
config USB_G_DBG_REQ_U_SERIAL
       tristate

if USB_F_ACM_REQ_U_SERIAL = y || USB_F_SERIAL_REQ_U_SERIAL = y || USB_F_OBEX_REQ_U_SERIAL = y || USB_G_DBG_REQ_U_SERIAL = y
config USB_U_SERIAL_SELECTOR
       tristate
       default y
       select USB_U_SERIAL
endif

if !(USB_F_ACM_REQ_U_SERIAL = y || USB_F_SERIAL_REQ_U_SERIAL = y || USB_F_OBEX_REQ_U_SERIAL = y || USB_G_DBG_REQ_U_SERIAL = y) && (USB_F_ACM_REQ_U_SERIAL = m || USB_F_SERIAL_REQ_U_SERIAL = m || USB_F_OBEX_REQ_U_SERIAL = m || USB_G_DBG_REQ_U_SERIAL = m)
config USB_U_SERIAL_SELECTOR
       tristate
       default m
       select USB_U_SERIAL
endif

config USB_U_ETHER
	tristate

# Just a dummy config which indicates that F_NCM requires U_ETHER in particular state
config USB_F_NCM_REQ_U_ETHER
       tristate

# Just a dummy config which indicates that F_ECM requires U_ETHER in particular state
config USB_F_ECM_REQ_U_ETHER
       tristate

# Just a dummy config which indicates that F_SUBSET requires U_ETHER in particular state
config USB_F_SUBSET_REQ_U_ETHER
       tristate

# Just a dummy config which indicates that F_RNDIS requires U_ETHER in particular state
config USB_F_RNDIS_REQ_U_ETHER
       tristate

# Just a dummy config which indicates that F_EEM requires U_ETHER in particular state
config USB_F_EEM_REQ_U_ETHER
       tristate

# Just a dummy config which indicates that F_PHONET requires U_ETHER in particular state
config USB_F_PHONET_REQ_U_ETHER
       tristate

if USB_F_NCM_REQ_U_ETHER = y || USB_F_ECM_REQ_U_ETHER = y || USB_F_SUBSET_REQ_U_ETHER = y || USB_F_RNDIS_REQ_U_ETHER = y || USB_F_EEM_REQ_U_ETHER = y || USB_F_PHONET_REQ_U_ETHER = y
config USB_U_ETHER_SELECTOR
       tristate
       default y
       select USB_U_ETHER
endif

if !(USB_F_NCM_REQ_U_ETHER = y || USB_F_ECM_REQ_U_ETHER = y || USB_F_SUBSET_REQ_U_ETHER = y || USB_F_RNDIS_REQ_U_ETHER = y || USB_F_EEM_REQ_U_ETHER = y || USB_F_PHONET_REQ_U_ETHER = y) && (USB_F_NCM_REQ_U_ETHER = m || USB_F_ECM_REQ_U_ETHER = m || USB_F_SUBSET_REQ_U_ETHER = m || USB_F_RNDIS_REQ_U_ETHER = m || USB_F_EEM_REQ_U_ETHER = m || USB_F_PHONET_REQ_U_ETHER = m)
config USB_U_ETHER_SELECTOR
       tristate
       default m
       select USB_U_ETHER
endif

config USB_F_SERIAL
	tristate

# Just a dummy config which indicates that serial gadget requires SERIAL in particular state
config USB_G_SERIAL_REQ_F_SERIAL
       tristate

if USB_CONFIGFS_F_SERIAL = y || USB_G_SERIAL_REQ_F_SERIAL = y
config USB_F_SERIAL_SELECTOR
       tristate
       default y
       select USB_F_SERIAL
       select USB_F_SERIAL_REQ_U_SERIAL
endif

if !(USB_CONFIGFS_F_SERIAL = y || USB_G_SERIAL_REQ_F_SERIAL = y) && (USB_CONFIGFS_F_SERIAL = m || USB_G_SERIAL_REQ_F_SERIAL = m)
config USB_F_SERIAL_SELECTOR
       tristate
       default m
       select USB_F_SERIAL
       select USB_F_SERIAL_REQ_U_SERIAL
endif

config USB_F_OBEX
	tristate

# Just a dummy config which indicates that serial gadget requires OBEX in particular state
config USB_G_SERIAL_REQ_F_OBEX
       tristate

# Just a dummy config which indicates that nokia gadget requires OBEX in particular state
config USB_G_NOKIA_REQ_F_OBEX
       tristate

if USB_CONFIGFS_F_OBEX = y || USB_G_SERIAL_REQ_F_OBEX = y || USB_G_NOKIA_REQ_F_OBEX = y
config USB_F_OBEX_SELECTOR
       tristate
       default y
       select USB_F_OBEX
       select USB_F_OBEX_REQ_U_SERIAL
endif

if !(USB_CONFIGFS_F_OBEX = y || USB_G_SERIAL_REQ_F_OBEX = y || USB_G_NOKIA_REQ_F_OBEX = y) && (USB_CONFIGFS_F_OBEX = m || USB_G_SERIAL_REQ_F_OBEX = m || USB_G_NOKIA_REQ_F_OBEX = m)
config USB_F_OBEX_SELECTOR
       tristate
       default m
       select USB_F_OBEX
       select USB_F_OBEX_REQ_U_SERIAL
endif

config USB_F_NCM
	tristate

# Just a dummy config which indicates that ncm gadget requires NCM in particular state
config USB_G_NCM_REQ_F_NCM
       tristate

if USB_CONFIGFS_F_NCM = y || USB_G_NCM_REQ_F_NCM = y
config USB_F_NCM_SELECTOR
       tristate
       default y
       select USB_F_NCM
       select USB_F_NCM_REQ_U_ETHER
endif

if !(USB_CONFIGFS_F_NCM = y || USB_G_NCM_REQ_F_NCM = y) && (USB_CONFIGFS_F_NCM = m || USB_G_NCM_REQ_F_NCM = m)
config USB_F_NCM_SELECTOR
       tristate
       default m
       select USB_F_NCM
       select USB_F_NCM_REQ_U_ETHER
endif

config USB_F_ECM
	tristate

# Just a dummy config which indicates that eth gadget requires ECM in particular state
config USB_G_ETH_REQ_F_ECM
       tristate

# Just a dummy config which indicates that cdc gadget requires ECM in particular state
config USB_G_CDC_COMPOSITE_REQ_F_ECM
       tristate

# Just a dummy config which indicates that nokia gadget requires ECM in particular state
config USB_G_NOKIA_REQ_F_ECM
       tristate

# Just a dummy config which indicates that functionfs gadget requires ECM in particular state
config USB_G_FUNCTIONFS_REQ_F_ECM
       tristate

# Just a dummy config which indicates that multi gadget requires ECM in particular state
config USB_G_MULTI_REQ_F_ECM
       tristate

if USB_CONFIGFS_F_ECM = y || USB_G_ETH_REQ_F_ECM = y || USB_G_CDC_COMPOSITE_REQ_F_ECM = y || USB_G_NOKIA_REQ_F_ECM = y || USB_G_FUNCTIONFS_REQ_F_ECM = y || USB_G_MULTI_REQ_F_ECM = y
config USB_F_ECM_SELECTOR
       tristate
       default y
       select USB_F_ECM
       select USB_F_ECM_REQ_U_ETHER
endif

if !(USB_CONFIGFS_F_ECM = y || USB_G_ETH_REQ_F_ECM = y || USB_G_CDC_COMPOSITE_REQ_F_ECM = y || USB_G_NOKIA_REQ_F_ECM = y || USB_G_FUNCTIONFS_REQ_F_ECM = y || USB_G_MULTI_REQ_F_ECM = y) && (USB_CONFIGFS_F_ECM = m || USB_G_ETH_REQ_F_ECM = m || USB_G_CDC_COMPOSITE_REQ_F_ECM = m || USB_G_NOKIA_REQ_F_ECM = m || USB_G_FUNCTIONFS_REQ_F_ECM = m || USB_G_MULTI_REQ_F_ECM = m)
config USB_F_ECM_SELECTOR
       tristate
       default m
       select USB_F_ECM
       select USB_F_ECM_REQ_U_ETHER
endif

config USB_F_PHONET
	tristate

# Just a dummy config which indicates that nokia gadget requires PHONET in particular state
config USB_G_NOKIA_REQ_F_PHONET
       tristate

if USB_CONFIGFS_F_PHONET = y || USB_G_NOKIA_REQ_F_PHONET = y
config USB_F_PHONET_SELECTOR
       tristate
       default y
       select USB_F_PHONET
       select USB_F_PHONET_REQ_U_ETHER
endif

if !(USB_CONFIGFS_F_PHONET = y || USB_G_NOKIA_REQ_F_PHONET = y) && (USB_CONFIGFS_F_PHONET = m || USB_G_NOKIA_REQ_F_PHONET = m)
config USB_F_PHONET_SELECTOR
       tristate
       default m
       select USB_F_PHONET
       select USB_F_PHONET_REQ_U_ETHER
endif

config USB_F_EEM
	tristate

# Just a dummy config which indicates that eth gadget requires EEM in particular state
config USB_G_ETH_REQ_F_EEM
       tristate

if USB_CONFIGFS_F_EEM = y || USB_G_ETH_REQ_F_EEM = y
config USB_F_EEM_SELECTOR
       tristate
       default y
       select USB_F_EEM
       select USB_F_EEM_REQ_U_ETHER
endif

if !(USB_CONFIGFS_F_EEM = y || USB_G_ETH_REQ_F_EEM = y) && (USB_CONFIGFS_F_EEM = m || USB_G_ETH_REQ_F_EEM = m)
config USB_F_EEM_SELECTOR
       tristate
       default m
       select USB_F_EEM
       select USB_F_EEM_REQ_U_ETHER
endif

config USB_F_SUBSET
	tristate

# Just a dummy config which indicates that eth gadget requires SUBSET in particular state
config USB_G_ETH_REQ_F_SUBSET
       tristate

# Just a dummy config which indicates that functionfs gadget requires SUBSET in particular state
config USB_G_FUNCTIONFS_REQ_F_SUBSET
       tristate

if USB_CONFIGFS_F_SUBSET = y || USB_G_ETH_REQ_F_SUBSET = y || USB_G_FUNCTIONFS_REQ_F_SUBSET = y
config USB_F_SUBSET_SELECTOR
       tristate
       default y
       select USB_F_SUBSET
       select USB_F_SUBSET_REQ_U_ETHER
endif

if !(USB_CONFIGFS_F_SUBSET = y || USB_G_ETH_REQ_F_SUBSET = y || USB_G_FUNCTIONFS_REQ_F_SUBSET = y) && (USB_CONFIGFS_F_SUBSET = m || USB_G_ETH_REQ_F_SUBSET = m || USB_G_FUNCTIONFS_REQ_F_SUBSET = m)
config USB_F_SUBSET_SELECTOR
       tristate
       default m
       select USB_F_SUBSET
       select USB_F_SUBSET_REQ_U_ETHER
endif

config USB_F_RNDIS
	tristate

# Just a dummy config which indicates that eth gadget requires RNDIS in particular state
config USB_G_ETH_REQ_F_RNDIS
       tristate

# Just a dummy config which indicates that functionfs gadget requires RNDIS in particular state
config USB_G_FUNCTIONFS_REQ_F_RNDIS
       tristate

# Just a dummy config which indicates that multi gadget requires RNDIS in particular state
config USB_G_MULTI_REQ_F_RNDIS
       tristate

if USB_CONFIGFS_F_RNDIS = y || USB_G_ETH_REQ_F_RNDIS = y || USB_G_FUNCTIONFS_REQ_F_RNDIS = y || USB_G_MULTI_REQ_F_RNDIS = y
config USB_F_RNDIS_SELECTOR
       tristate
       default y
       select USB_F_RNDIS
       select USB_F_RNDIS_REQ_U_ETHER
endif

if !(USB_CONFIGFS_F_RNDIS = y || USB_G_ETH_REQ_F_RNDIS = y || USB_G_FUNCTIONFS_REQ_F_RNDIS = y || USB_G_MULTI_REQ_F_RNDIS = y) && (USB_CONFIGFS_F_RNDIS = m || USB_G_ETH_REQ_F_RNDIS = m || USB_G_FUNCTIONFS_REQ_F_RNDIS = m || USB_G_MULTI_REQ_F_RNDIS = m)
config USB_F_RNDIS_SELECTOR
       tristate
       default m
       select USB_F_RNDIS
       select USB_F_RNDIS_REQ_U_ETHER
endif

config USB_F_MASS_STORAGE
	tristate

# Just a dummy config which indicates that mass storage gadget requires MASS_STORAGE in particular state
config USB_G_MASS_STORAGE_REQ_F_MASS_STORAGE
       tristate

# Just a dummy config which indicates that nokia gadget requires MASS_STORAGE in particular state
config USB_G_NOKIA_REQ_F_MASS_STORAGE
       tristate

# Just a dummy config which indicates that acm ms gadget requires MASS_STORAGE in particular state
config USB_G_ACM_MS_REQ_F_MASS_STORAGE
       tristate

# Just a dummy config which indicates that multi gadget requires MASS_STORAGE in particular state
config USB_G_MULTI_REQ_F_MASS_STORAGE
       tristate

if USB_CONFIGFS_F_MASS_STORAGE = y || USB_G_MASS_STORAGE_REQ_F_MASS_STORAGE = y || USB_G_NOKIA_REQ_F_MASS_STORAGE = y || USB_G_ACM_MS_REQ_F_MASS_STORAGE = y|| USB_G_MULTI_REQ_F_MASS_STORAGE = y
config USB_F_MASS_STORAGE_SELECTOR
       tristate
       default y
       select USB_F_MASS_STORAGE
endif

if !(USB_CONFIGFS_F_MASS_STORAGE = y || USB_G_MASS_STORAGE_REQ_F_MASS_STORAGE = y || USB_G_NOKIA_REQ_F_MASS_STORAGE = y || USB_G_ACM_MS_REQ_F_MASS_STORAGE = y || USB_G_MULTI_REQ_F_MASS_STORAGE = y) && (USB_CONFIGFS_F_MASS_STORAGE = m || USB_G_MASS_STORAGE_REQ_F_MASS_STORAGE = m || USB_G_NOKIA_REQ_F_MASS_STORAGE = m || USB_G_ACM_MS_REQ_F_MASS_STORAGE = m ||USB_G_MULTI_REQ_F_MASS_STORAGE = m)
config USB_F_MASS_STORAGE_SELECTOR
       tristate
       default m
       select USB_F_MASS_STORAGE
endif

config USB_F_FS
	tristate

# Just a dummy config which indicates that functionfs gadget requires F_FS in particular state
config USB_G_FUNCTIONFS_REQ_F_FS
       tristate

if USB_CONFIGFS_F_FS = y || USB_G_FUNCTIONFS_REQ_F_FS = y
config USB_F_FS_SELECTOR
       tristate
       default y
       select USB_F_FS
endif

if !(USB_CONFIGFS_F_FS = y || USB_G_FUNCTIONFS_REQ_F_FS = y) && (USB_CONFIGFS_F_FS = m || USB_G_FUNCTIONFS_REQ_F_FS = m)
config USB_F_FS_SELECTOR
       tristate
       default m
       select USB_F_FS
endif

config USB_F_UAC1
	tristate

# Just a dummy config which indicates that audio gadget requires UAC1 in particular state
config USB_G_AUDIO_REQ_F_UAC1
       tristate

if USB_CONFIGFS_F_UAC1 = y || USB_G_AUDIO_REQ_F_UAC1 = y
config USB_F_UAC1_SELECTOR
       tristate
       default y
       select USB_F_UAC1
       select SND_PCM
endif

if !(USB_CONFIGFS_F_UAC1 = y || USB_G_AUDIO_REQ_F_UAC1 = y) && (USB_CONFIGFS_F_UAC1 = m || USB_G_AUDIO_REQ_F_UAC1 = m)
config USB_F_UAC1_SELECTOR
       tristate
       default m
       select USB_F_UAC1
       select SND_PCM
endif

config USB_F_UAC2
	tristate

# Just a dummy config which indicates that audio gadget requires UAC2 in particular state
config USB_G_AUDIO_REQ_F_UAC2
       tristate

if USB_CONFIGFS_F_UAC2 = y || USB_G_AUDIO_REQ_F_UAC2 = y
config USB_F_UAC2_SELECTOR
       tristate
       default y
       select USB_F_UAC2
       select SND_PCM
endif

if !(USB_CONFIGFS_F_UAC2 = y || USB_G_AUDIO_REQ_F_UAC2 = y) && (USB_CONFIGFS_F_UAC2 = m || USB_G_AUDIO_REQ_F_UAC2 = m)
config USB_F_UAC2_SELECTOR
       tristate
       default m
       select USB_F_UAC2
       select SND_PCM
endif

config USB_F_UVC
	tristate

# Just a dummy config which indicates that webcam gadget requires UVC in particular state
config USB_G_WEBCAM_REQ_F_UVC
       tristate

if USB_CONFIGFS_F_UVC = y || USB_G_WEBCAM_REQ_F_UVC = y
config USB_F_UVC_SELECTOR
       tristate
       default y
       select USB_F_UVC
       select VIDEOBUF2_VMALLOC
endif

if !(USB_CONFIGFS_F_UVC = y || USB_G_WEBCAM_REQ_F_UVC = y) && (USB_CONFIGFS_F_UVC = m || USB_G_WEBCAM_REQ_F_UVC = m)
config USB_F_UVC_SELECTOR
       tristate
       default m
       select USB_F_UVC
       select VIDEOBUF2_VMALLOC
endif

config USB_F_MIDI
	tristate

# Just a dummy config which indicates that midi gadget requires MIDI in particular state
config USB_G_MIDI_REQ_F_MIDI
       tristate

if USB_CONFIGFS_F_MIDI = y || USB_G_MIDI_REQ_F_MIDI = y
config USB_F_MIDI_SELECTOR
       tristate
       default y
       select USB_F_MIDI
       select SND_RAWMIDI
endif

if !(USB_CONFIGFS_F_MIDI = y || USB_G_MIDI_REQ_F_MIDI = y) && (USB_CONFIGFS_F_MIDI = m || USB_G_MIDI_REQ_F_MIDI = m)
config USB_F_MIDI_SELECTOR
       tristate
       default m
       select USB_F_MIDI
       select SND_RAWMIDI
endif

config USB_F_HID
	tristate

# Just a dummy config which indicates that hid gadget requires HID in particular state
config USB_G_HID_REQ_F_HID
       tristate

if USB_CONFIGFS_F_HID = y || USB_G_HID_REQ_F_HID = y
config USB_F_HID_SELECTOR
       tristate
       default y
       select USB_F_HID
endif

if !(USB_CONFIGFS_F_HID = y || USB_G_HID_REQ_F_HID = y) && (USB_CONFIGFS_F_HID = m || USB_G_HID_REQ_F_HID = m)
config USB_F_HID_SELECTOR
       tristate
       default m
       select USB_F_HID
endif

config USB_F_PRINTER
	tristate

# Just a dummy config which indicates that printer gadget requires PRINTER in particular state
config USB_G_PRINTER_REQ_F_PRINTER
       tristate

if USB_CONFIGFS_F_PRINTER = y || USB_G_PRINTER_REQ_F_PRINTER = y
config USB_F_PRINTER_SELECTOR
       tristate
       default y
       select USB_F_PRINTER
endif

if !(USB_CONFIGFS_F_PRINTER = y || USB_G_PRINTER_REQ_F_PRINTER = y) && (USB_CONFIGFS_F_PRINTER = m || USB_G_PRINTER_REQ_F_PRINTER = m)
config USB_F_PRINTER_SELECTOR
       tristate
       default m
       select USB_F_PRINTER
endif

# Just a dummy config which indicates that tcm gadget requires TCM in particular state
config USB_G_TCM_REQ_F_TCM
       tristate

if USB_CONFIGFS_F_TCM = y || USB_G_TCM_REQ_F_TCM = y
config USB_F_TCM_SELECTOR
       tristate
       default y
       select USB_F_TCM
endif

if !(USB_CONFIGFS_F_TCM = y || USB_G_TCM_REQ_F_TCM = y) && (USB_CONFIGFS_F_TCM = m || USB_G_TCM_REQ_F_TCM = m)
config USB_F_TCM_SELECTOR
       tristate
       default m
       select USB_F_TCM
endif

if USB_LIBCOMPOSITE

menu "USB Functions"

config USB_CONFIGFS_F_SERIAL
	tristate "Generic serial bulk in/out"
	depends on USB_LIBCOMPOSITE
	depends on TTY
	help
	  The function talks to the Linux-USB generic serial driver.

config USB_CONFIGFS_F_ACM
	tristate "Abstract Control Model (CDC ACM)"
	depends on USB_LIBCOMPOSITE
	depends on TTY
	help
	  ACM serial link.  This function can be used to interoperate with
	  MS-Windows hosts or with the Linux-USB "cdc-acm" driver.

config USB_CONFIGFS_F_OBEX
	tristate "Object Exchange Model (CDC OBEX)"
	depends on USB_LIBCOMPOSITE
	depends on TTY
	help
	  You will need a user space OBEX server talking to /dev/ttyGS*,
	  since the kernel itself doesn't implement the OBEX protocol.

config USB_CONFIGFS_F_NCM
	tristate "Network Control Model (CDC NCM)"
	depends on USB_LIBCOMPOSITE
	depends on NET
	help
	  NCM is an advanced protocol for Ethernet encapsulation, allows
	  grouping of several ethernet frames into one USB transfer and
	  different alignment possibilities.

config USB_CONFIGFS_F_ECM
	tristate "Ethernet Control Model (CDC ECM)"
	depends on USB_LIBCOMPOSITE
	depends on NET
	help
	  The "Communication Device Class" (CDC) Ethernet Control Model.
	  That protocol is often avoided with pure Ethernet adapters, in
	  favor of simpler vendor-specific hardware, but is widely
	  supported by firmware for smart network devices.

config USB_CONFIGFS_F_SUBSET
	tristate "Ethernet Control Model (CDC ECM) subset"
	depends on USB_LIBCOMPOSITE
	depends on NET
	help
	  On hardware that can't implement the full protocol,
	  a simple CDC subset is used, placing fewer demands on USB.

config USB_CONFIGFS_F_RNDIS
	tristate "RNDIS"
	depends on USB_LIBCOMPOSITE
	depends on NET
	help
	   Microsoft Windows XP bundles the "Remote NDIS" (RNDIS) protocol,
	   and Microsoft provides redistributable binary RNDIS drivers for
	   older versions of Windows.

	   To make MS-Windows work with this, use Documentation/usb/linux.inf
	   as the "driver info file".  For versions of MS-Windows older than
	   XP, you'll need to download drivers from Microsoft's website; a URL
	   is given in comments found in that info file.

config USB_CONFIGFS_F_EEM
	tristate "Ethernet Emulation Model (EEM)"
	depends on USB_LIBCOMPOSITE
	depends on NET
	help
	  CDC EEM is a newer USB standard that is somewhat simpler than CDC ECM
	  and therefore can be supported by more hardware.  Technically ECM and
	  EEM are designed for different applications.  The ECM model extends
	  the network interface to the target (e.g. a USB cable modem), and the
	  EEM model is for mobile devices to communicate with hosts using
	  ethernet over USB.  For Linux gadgets, however, the interface with
	  the host is the same (a usbX device), so the differences are minimal.

config USB_CONFIGFS_F_PHONET
	tristate "Phonet protocol"
	depends on USB_LIBCOMPOSITE
	depends on NET
	depends on PHONET
	help
	  The Phonet protocol implementation for USB device.

config USB_CONFIGFS_F_MASS_STORAGE
	tristate "Mass storage"
	depends on USB_LIBCOMPOSITE
	depends on BLOCK
	help
	  The Mass Storage Gadget acts as a USB Mass Storage disk drive.
	  As its storage repository it can use a regular file or a block
	  device (in much the same way as the "loop" device driver),
	  specified as a module parameter or sysfs option.

config USB_CONFIGFS_F_SS_LB
	tristate "Loopback and sourcesink function (for testing)"
	depends on USB_LIBCOMPOSITE
	help
	  Loopback function loops back a configurable number of transfers.
	  Sourcesink function either sinks and sources bulk data.
	  It also implements control requests, for "chapter 9" conformance.
	  Make this be the first driver you try using on top of any new
	  USB peripheral controller driver.  Then you can use host-side
	  test software, like the "usbtest" driver, to put your hardware
	  and its driver through a basic set of functional tests.

config USB_CONFIGFS_F_FS
	tristate "Function filesystem (FunctionFS)"
	depends on USB_LIBCOMPOSITE
	help
	  The Function Filesystem (FunctionFS) lets one create USB
	  composite functions in user space in the same way GadgetFS
	  lets one create USB gadgets in user space.  This allows creation
	  of composite gadgets such that some of the functions are
	  implemented in kernel space (for instance Ethernet, serial or
	  mass storage) and other are implemented in user space.

config USB_CONFIGFS_F_UAC1
	tristate "Audio Class 1.0"
	depends on USB_LIBCOMPOSITE
	depends on SND
	help
	  This Audio function implements 1 AudioControl interface,
	  1 AudioStreaming Interface each for USB-OUT and USB-IN.
	  This driver requires a real Audio codec to be present
	  on the device.

config USB_CONFIGFS_F_UAC2
	tristate "Audio Class 2.0"
	depends on USB_LIBCOMPOSITE
	depends on SND
	help
	  This Audio function is compatible with USB Audio Class
	  specification 2.0. It implements 1 AudioControl interface,
	  1 AudioStreaming Interface each for USB-OUT and USB-IN.
	  This driver doesn't expect any real Audio codec to be present
	  on the device - the audio streams are simply sinked to and
	  sourced from a virtual ALSA sound card created. The user-space
	  application may choose to do whatever it wants with the data
	  received from the USB Host and choose to provide whatever it
	  wants as audio data to the USB Host.

config USB_CONFIGFS_F_MIDI
	tristate "MIDI function"
	depends on USB_LIBCOMPOSITE
	depends on SND
	help
	  The MIDI Function acts as a USB Audio device, with one MIDI
	  input and one MIDI output. These MIDI jacks appear as
	  a sound "card" in the ALSA sound system. Other MIDI
	  connections can then be made on the gadget system, using
	  ALSA's aconnect utility etc.

config USB_CONFIGFS_F_HID
	tristate "HID function"
	depends on USB_LIBCOMPOSITE
	help
	  The HID function driver provides generic emulation of USB
	  Human Interface Devices (HID).

	  For more information, see Documentation/usb/gadget_hid.txt.

config USB_CONFIGFS_F_UVC
	tristate "USB Webcam function"
	depends on USB_LIBCOMPOSITE
	depends on VIDEO_DEV
	help
	  The Webcam function acts as a composite USB Audio and Video Class
	  device. It provides a userspace API to process UVC control requests
	  and stream video data to the host.

config USB_CONFIGFS_F_PRINTER
	tristate "Printer function"
	depends on USB_LIBCOMPOSITE
	help
	  The Printer function channels data between the USB host and a
	  userspace program driving the print engine. The user space
	  program reads and writes the device file /dev/g_printer<X> to
	  receive or send printer data. It can use ioctl calls to
	  the device file to get or set printer status.

	  For more information, see Documentation/usb/gadget_printer.txt
	  which includes sample code for accessing the device file.

endmenu

source "drivers/usb/gadget/legacy/Kconfig"

endif # USB_LIBCOMPOSITE
endif # USB_GADGET
```
