## drivers/gpu/arm/midgard/Kconfig
```kconfig
menuconfig MALI_MIDGARD
	tristate "Mali Midgard series support"
	default n
	help
	  Enable this option to build support for a ARM Mali Midgard GPU.

	  To compile this driver as a module, choose M here:
	  this will generate a single module, called mali_kbase.

choice
	depends on MALI_MIDGARD
	prompt "Select MALI VER"
	default MALI_VER_R5P0_06REL0

config MALI_VER_R12P0_04REL0
	bool "Mali Midgard Version R12P0-04REL0"
	help
	  Choose this option to select DDK version.

if MALI_VER_R12P0_04REL0
source "drivers/gpu/arm/midgard/r12p0_04rel0/Kconfig"
endif

endchoice
```

## drivers/gpu/drm/bridge/Kconfig
```kconfig
config DRM_DW_HDMI
	tristate
	depends on DRM
	select DRM_KMS_HELPER

config DRM_PTN3460
	tristate "PTN3460 DP/LVDS bridge"
	depends on DRM
	depends on OF
	select DRM_KMS_HELPER
	select DRM_PANEL
	---help---
	  ptn3460 eDP-LVDS bridge chip driver.

config DRM_PS8622
	tristate "Parade eDP/LVDS bridge"
	depends on DRM
	depends on OF
	select DRM_PANEL
	select DRM_KMS_HELPER
	select BACKLIGHT_LCD_SUPPORT
	select BACKLIGHT_CLASS_DEVICE
	---help---
	  parade eDP-LVDS bridge chip driver.

config DRM_SII8620
	tristate "Silicon Image SII8620 HDMI/MHL bridge"
	depends on DRM
	depends on OF
	select DRM_KMS_HELPER
	depends on I2C
	help
	  Say Y here if you want support for the MHL interface.
	  It is an I2C driver, that detects connection of MHL bridge
	  and starts encapsulation of HDMI signal.
```

## drivers/gpu/drm/exynos/Kconfig
```kconfig
config DRM_EXYNOS
	tristate "DRM Support for Samsung SoC EXYNOS Series"
	depends on DRM && PLAT_SAMSUNG
	select DRM_KMS_HELPER
	select FB_CFB_FILLRECT
	select FB_CFB_COPYAREA
	select FB_CFB_IMAGEBLIT
	select VT_HW_CONSOLE_BINDING if FRAMEBUFFER_CONSOLE
	help
	  Choose this option if you have a Samsung SoC EXYNOS chipset.
	  If M is selected the module will be called exynosdrm.

config DRM_EXYNOS_IOMMU
	bool "EXYNOS DRM IOMMU Support"
	depends on DRM_EXYNOS && EXYNOS_IOMMU && ARM_DMA_USE_IOMMU
	help
	  Choose this option if you want to use IOMMU feature for DRM.

config DRM_EXYNOS_DMABUF
	bool "EXYNOS DRM DMABUF"
	depends on DRM_EXYNOS
	help
	  Choose this option if you want to use DMABUF feature for DRM.

config DRM_EXYNOS_FIMD
	bool "EXYNOS DRM FIMD"
	depends on DRM_EXYNOS && !FB_S3C
	help
	  Choose this option if you want to use Exynos FIMD for DRM.

config DRM_EXYNOS_FIMD_WB
	bool "EXYNOS DRM FIMD WB"
	depends on DRM_EXYNOS_FIMD
	help
	  This option enables writeback operations in FIMD for DRM.
	  It can support fimd streams data to fimc destinations ram.
	  writeback operations support final blended stream.
	  when enable this options.

config DRM_EXYNOS_FIMD_DEBUG_FIFO
	bool "EXYNOS DRM FIMD Debug FIFO"
	depends on DRM_EXYNOS_FIMD
	help
	  This option enables FIFO under-run operations in FIMD for DRM.
	  It can check fimd streams FIFO under-run state in each overlay.
	  FIFO under-run contain with bus frequency.
	  If you want to check FIFO under-run state, than enable it.

config DRM_EXYNOS_HDMI
	bool "EXYNOS DRM HDMI"
	depends on DRM_EXYNOS && !VIDEO_SAMSUNG_S5P_TV
	help
	  Choose this option if you want to use Exynos HDMI for DRM.

config DRM_EXYNOS_DDC
	bool "EXYNOS DRM DDC"
	depends on DRM_EXYNOS_HDMI
	help
	  Choose this option if you want to use Exynos DDC for DRM.

config DRM_EXYNOS_HDCP
	bool "EXYNOS DRM HDCP"
	depends on DRM_EXYNOS_HDMI
	help
	  This option enables HDCP in HDMI for DRM.
	  It can support contents protection HDMI streaming packet.
	  HDCP is stand for High-bandwidth Digital Content Protection.
	  supports version HDCP v1.1.

config DRM_EXYNOS_VIDI
	bool "EXYNOS DRM Virtual Display"
	depends on DRM_EXYNOS
	help
	  Choose this option if you want to use Exynos VIDI for DRM.

config DRM_EXYNOS_G2D
	bool "EXYNOS DRM G2D"
	depends on DRM_EXYNOS && !VIDEO_SAMSUNG_S5P_G2D
	help
	  Choose this option if you want to use Exynos G2D for DRM.

config DRM_EXYNOS_IPP
	bool "EXYNOS DRM IPP"
	depends on DRM_EXYNOS
	help
	  This option enables IPP drivers for FIMC, GSC, Rotator.
	  It can support user space ioctl for each devices.
	  ipp operations support rotating and scaling, writeback, flip, output
	  when enable this options.

config DRM_EXYNOS_ROTATOR
	bool "EXYNOS DRM Rotator"
	depends on DRM_EXYNOS_IPP
	help
	  Choose this option if you want to use Exynos Rotator for DRM.

config DRM_EXYNOS_FIMC
	bool "EXYNOS DRM FIMC"
	depends on DRM_EXYNOS_IPP
	help
	  Choose this option if you want to use Exynos FIMC for DRM.

config DRM_EXYNOS_GSC
	bool "EXYNOS DRM GSC"
	depends on DRM_EXYNOS_IPP && !ARCH_EXYNOS4
	help
	  Choose this option if you want to use Exynos GSC for DRM.

config DRM_EXYNOS_SC
	bool "EXYNOS DRM SC"
	depends on DRM_EXYNOS_IPP && !ARCH_EXYNOS4
	help
	  Choose this option if you want to use Exynos SC for DRM.

config DRM_EXYNOS_DBG
	bool "EXYNOS DRM DBG"
	depends on DRM_EXYNOS
	help
	  Choose this option if you want to use debug feature.

config DRM_EXYNOS_IPP_TC
	bool "EXYNOS DRM IPP TRAFFIC CONTROL"
	depends on DRM_EXYNOS_IPP
	help
	  This option enables IPP drivers for traffic control.

config DRM_EXYNOS_LOGO
	bool "EXYNOS DRM LOGO"
	depends on DRM_EXYNOS
	help
	  Choose this option if you want to use logo feature.
	  It parses kernel command line to get logo information,
	  and overwrites fbdev gem ops.

config DRM_FIMD_GAMMA_TUNE
	bool "EXYNOS FIMD GAMMA TUNE"
	depends on DRM_EXYNOS_FIMD && ARCH_EXYNOS4
	help
	  Choose this option if you want to apply S-curve gamma,
	  using fimd register control under outdoor mode.

config SLP_FAKE_WVGA_DRM_MODE_SUPPORT
	bool "Support fake WVGA DRM mode"
	depends on DRM_EXYNOS
	help
	  Choose this option if you want to use fake WVGA DRM mode feature
	  for Xorg in HD mode. It remains LCD H/W panel information in HD,
	  only changes DRM mode to WVGA forcely.
	  Caution: It is only valid at LVDS.

config DISPLAY_EARLY_DPMS
	bool "Display early DPMS"
	depends on DRM_EXYNOS
	help
	  Choose this option if you want to use early dpms feature.
```

## drivers/gud/Kconfig
```kconfig
#
# MobiCore configuration
#
if SOC_EXYNOS5410
source "drivers/gud/gud-exynos5410/Kconfig"
endif

if SOC_EXYNOS5420
source "drivers/gud/gud-exynos5420/Kconfig"
endif
```

## drivers/gud/TlcTui/Kconfig
```kconfig
config TRUSTONIC_TRUSTED_UI
    tristate "<t-base TUI"
    depends on MOBICORE_API
    ---help---
      Enable <t-base Trusted User Interface

config TRUSTONIC_TRUSTED_UI_FB_BLANK
    bool "<t-base TUI with fb_blank"
    depends on TRUSTONIC_TRUSTED_UI
    ---help---
      Blank the framebuffer before starting a TUI session

config TRUSTONIC_TRUSTED_UI_NOTIFY
    bool "<t-base TUI to support notify"
    depends on TRUSTONIC_TRUSTED_UI
```

## drivers/hardkernel/Kconfig
```kconfig
menu "ODROID Specific Hardware"

config ODROID_EXYNOS5_SP
	tristate "Enable the INA231 Sensor on ODROID-EXYNOS5"
	depends on I2C && ARCH_EXYNOS5
	default n
	---help---
		Enables the INA231 Sensor on ODROID-EXYNOS5

config ODROID_EXYNOS5_IOBOARD
	tristate "Enable the ODROID EXYNOS5 IOBOARD Drivers"
	depends on ARCH_EXYNOS5
	default n
	---help---
		Enables the IO-Expansion BOARD Drivers

endmenu
```

## drivers/iio/barometer/Kconfig
```kconfig
#
# Magnetometer sensors
#
menu "Barometer sensors"

config SENSORS_LPS331
        tristate "STMicro LPS331 driver"
        depends on I2C
        help
          Driver for STMicro LPS331

endmenu
```

## drivers/media/platform/exynos/fimc-is/Kconfig
```kconfig
config VIDEO_EXYNOS_FIMC_IS
        bool "Exynos FIMC-IS (Image Subsystem) driver"
        depends on VIDEO_EXYNOS
        select MEDIA_EXYNOS
        select USE_VENDER_FEATURE
        default n
        help
          This is a v4l2 driver for exynos FIMC-IS device.
config CAMERA_EEPROM_SUPPORT_REAR
        bool "Enable eeprom for rear cam"
        depends on VIDEO_EXYNOS_FIMC_IS
        default n
        help
          Enable eeprom for rear cam.
config CAMERA_EEPROM_SUPPORT_FRONT
        bool "Enable eeprom for front cam"
        depends on VIDEO_EXYNOS_FIMC_IS
        default n
        help
          Enable eeprom for front cam.
config COMPANION_USE
        bool "Enable to companion"
        depends on VIDEO_EXYNOS_FIMC_IS
        default n
        help
          Enable to companion.
config OIS_USE
        bool "Enable to ois"
        depends on VIDEO_EXYNOS_FIMC_IS
        default n
        help
          Enable to ois.
config OIS_FW_UPDATE_THREAD_USE
        bool "Enable to ois fw update thread"
        depends on OIS_USE
        default n
        help
          Enable to ois fw update thread.
config AF_HOST_CONTROL
        bool "Enable to af control"
        depends on VIDEO_EXYNOS_FIMC_IS
        default n
        help
          Enable to af control.
config USE_VENDER_FEATURE
        bool "Use vendor specific features"
        depends on VIDEO_EXYNOS_FIMC_IS
        default n
        help
          Enable to use the vender.
config CAMERA_SENSOR_6D1_OBJ
        bool "Use 6D1 camera sensor"
        depends on VIDEO_EXYNOS_FIMC_IS
        default n
        help
          Use to build 6D1 camera sensor.
config CAMERA_SENSOR_IMX240_OBJ
        bool "Use IMX240 camera sensor"
        depends on VIDEO_EXYNOS_FIMC_IS
        default n
        help
          Use to build IMX240 camera sensor.
```

## drivers/media/platform/exynos5-is/Kconfig
```kconfig
config VIDEO_SAMSUNG_EXYNOS5_CAMERA
	bool "Samsung Exynos5 SoC series Camera Subsystem driver"
	depends on VIDEO_V4L2 && VIDEO_V4L2_SUBDEV_API
	depends on VIDEO_SAMSUNG_EXYNOS4_IS
	help
	  This is a V4L2 driver for Exynos5xxx, Exynos3250 SoC series camera
	  subsystem.

	  To compile this driver as a module, choose M here: the
	  module will be called exynos-iss.

if VIDEO_SAMSUNG_EXYNOS5_CAMERA

config VIDEO_SAMSUNG_EXYNOS5_FIMC_IS
	bool "Samsung Exynos5/Exynos3250 SoC Imaging Subsystem (FIMC-IS) driver"
	depends on I2C && OF
	depends on VIDEO_EXYNOS4_FIMC_IS
	select VIDEOBUF2_DMA_CONTIG
	help
	  This is a V4L2 driver for Samsung Exynos5xxx, Exynos3250 SoC series
	  Imaging Subsystem (FIMC-IS).

endif #VIDEO_SAMSUNG_EXYNOS5_CAMERA
```

## drivers/misc/artiktee/Kconfig
```kconfig
#
# To support TEE for ARTIK
#
menu "ARTIK TEE(Trusted Execution Environment)"

config ARTIK_TRUSTZONE_DRIVER
	tristate "ARTIK TrustZone driver"
	depends on (ARM_TRUSTZONE && (SOC_EXYNOS3250 || SOC_EXYNOS5422))
	default y
	help
		This driver allows you can communicate with ARTIK Secure OS.
		When you use this driver, the platform has to support Secure OS.
endmenu
```

## drivers/misc/modem_if/Kconfig
```kconfig
menuconfig SEC_MODEM_IF
	bool "Samsung Mobile SIT Modem Interface"
	default n
	---help---
	  Samsung Modem Interface Driver

config LINK_DEVICE_SHMEM
	bool "modem driver link device shared memory"
	depends on SEC_MODEM_IF
	default y

config CP_SECURE_BOOT
	bool "Support CP Secure Boot"
	depends on SEC_MODEM_IF
	default y

config DEBUG_MODEM_IF
	bool "enable modem if debug option"
	depends on SEC_MODEM_IF
	default n

config SIM_DETECT
	bool "SIM_DETECT pin"
	depends on SEC_MODEM_IF
	default n
```

## drivers/nfc/Kconfig
```kconfig
#
# Near Field Communication (NFC) devices
#

menu "Near Field Communication (NFC) devices"
	depends on NFC

config NFC_NXP
	bool "NFC_NXP"
	default n
	help
	  This adds support for nxp 67t chip based I2C devices. Select this if you
	  will use an NXP NFC driver for an nfc chip.
	  It supports card emual and tag read/write.

	  If unsure, say N.

config NFC_P61
	bool "NXP P61 eSE driver"
	depends on SPI
	default n
	help
	This adds support for P73N2M0 eSE chip based SPI interface.

config ESE_SECURE_ENABLE
         bool "eSE PIN Protection"
         depends on !TIZEN_SEC_KERNEL_ENG
         default n

config ESE_SECURE_GPIO
         string "eSE GPIO Group"

config ESE_SECURE_SPI_PORT
         int "eSE SPI port number"
         default 99

config ESE_SECURE_USI_MODE
         int "ese usi id"
         default 99

config ESE_SECURE_SPI_CLK_ENG
        bool "eSE Secure SPI CLK Configuration"
        depends on TIZEN_SEC_KERNEL_ENG
        default n
        help
	This adds support for Secure SPI on KERNEL_ENG

config NFC_WILINK
	tristate "Texas Instruments NFC WiLink driver"
	depends on TI_ST && NFC_NCI
	help
	  This enables the NFC driver for Texas Instrument's BT/FM/GPS/NFC
	  combo devices. This makes use of shared transport line discipline
	  core driver to communicate with the NFC core of the combo chip.

	  Say Y here to compile support for Texas Instrument's NFC WiLink driver
	  into the kernel or say M to compile it as module.

config NFC_TRF7970A
	tristate "Texas Instruments TRF7970a NFC driver"
	depends on SPI && NFC_DIGITAL
	help
	  This option enables the NFC driver for Texas Instruments' TRF7970a
	  device. Such device supports 5 different protocols: ISO14443A,
	  ISO14443B, FeLiCa, ISO15693 and ISO18000-3.

	  Say Y here to compile support for TRF7970a into the kernel or
	  say M  to compile it as a module. The module will be called
	  trf7970a.ko.

config NFC_MEI_PHY
	tristate "MEI bus NFC device support"
	depends on INTEL_MEI && NFC_HCI
	help
	  This adds support to use an mei bus nfc device. Select this if you
	  will use an HCI NFC driver for an NFC chip connected behind an
	  Intel's Management Engine chip.

	  If unsure, say N.

config NFC_SIM
	tristate "NFC hardware simulator driver"
	depends on NFC_DIGITAL
	help
	  This driver declares two virtual NFC devices supporting NFC-DEP
	  protocol. An LLCP connection can be established between them and
	  all packets sent from one device is sent back to the other, acting as
	  loopback devices.

	  If unsure, say N.

config NFC_PORT100
	tristate "Sony NFC Port-100 Series USB device support"
	depends on USB
	depends on NFC_DIGITAL
	help
	  This adds support for Sony Port-100 chip based USB devices such as the
	  RC-S380 dongle.

	  If unsure, say N.

source "drivers/nfc/fdp/Kconfig"
source "drivers/nfc/pn544/Kconfig"
source "drivers/nfc/pn533/Kconfig"
source "drivers/nfc/microread/Kconfig"
source "drivers/nfc/nfcmrvl/Kconfig"
source "drivers/nfc/st21nfca/Kconfig"
source "drivers/nfc/st-nci/Kconfig"
source "drivers/nfc/nxp-nci/Kconfig"
source "drivers/nfc/s3fwrn5/Kconfig"
source "drivers/nfc/st95hf/Kconfig"
endmenu
```
