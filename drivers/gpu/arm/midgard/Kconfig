## drivers/phy/Kconfig
```kconfig
#
# PHY
#

menu "PHY Subsystem"

config GENERIC_PHY
	tristate "PHY Core"
	help
	  Generic PHY support.

	  This framework is designed to provide a generic interface for PHY
	  devices present in the kernel. This layer will have the generic
	  API by which phy drivers can create PHY using the phy framework and
	  phy users can obtain reference to the PHY. All the users of this
	  framework should select this config.

config PHY_EXYNOS_MIPI_VIDEO
	tristate "S5P/EXYNOS SoC series MIPI CSI-2/DSI PHY driver"
	help
	  Support for MIPI CSI-2 and MIPI DSI DPHY found on Samsung
	  S5P and EXYNOS SoCs.

config EXYNOS_PHY
	tristate "Exynos PHY driver"
	help
	  Support for PHY controllers on SoCs from Exynos family.

config PHY_SAMSUNG_USB2
	tristate "Samsung USB 2.0 PHY driver"
	select GENERIC_PHY
	select MFD_SYSCON
	help
	  Enable this to support the Samsung USB 2.0 PHY driver for Samsung
	  SoCs. This driver provides the interface for USB 2.0 PHY. Support for
	  particular SoCs has to be enabled in addition to this driver. Number
	  and type of supported phys depends on the SoC.

config PHY_EXYNOS4210_USB2
	bool "Support for Exynos 4210"
	depends on PHY_SAMSUNG_USB2
	depends on CPU_EXYNOS4210
	help
	  Enable USB PHY support for Exynos 4210. This option requires that
	  Samsung USB 2.0 PHY driver is enabled and means that support for this
	  particular SoC is compiled in the driver. In case of Exynos 4210 four
	  phys are available - device, host, HSIC0 and HSIC1.

config PHY_EXYNOS4X12_USB2
	bool "Support for Exynos 3250/4x12"
	depends on PHY_SAMSUNG_USB2
	depends on (SOC_EXYNOS3250 || SOC_EXYNOS4212 || SOC_EXYNOS4412)
	help
	  Enable USB PHY support for Exynos 3250/4x12. This option requires
	  that Samsung USB 2.0 PHY driver is enabled and means that support for
	  this particular SoC is compiled in the driver. In case of Exynos 4x12
	  four phys are available - device, host, HSIC0 and HSIC1.
endmenu
```

## drivers/power/asv/Kconfig
```kconfig
menuconfig POWER_ASV
	bool "Adaptive Supply Voltage (ASV) support"
	help
	  ASV is a technique used on Samsung SoCs which provides the
	  recommended supply voltage for some specific parts(like CPU, MIF, etc)
	  that support DVFS. For a given operating frequency, the voltage is
	  recommended based on SoCs ASV group. ASV group info is provided in the
	  chip id info which depends on the chip manufacturing process.

	  Say Y here to enable Adaptive Supply Voltage support.

if POWER_ASV

config POWER_EXYNOS_ASV
	bool "Adaptive Supply Voltage for Exynos"
	help
	  Exynos supports ASV depending upon the ASV group fused on chip.
	  Users can request ASV specific to a frequency for a particular member
	  from corresponding DVFS driver.

	  Say Y here to enable Exynos Adaptive Supply Voltage.

endif
```

## drivers/sensorhub/Kconfig
```kconfig
menu "Sensor HUB Drivers"

config SENSORS_SSP_STM_RINATO
	bool "Sensorhub for rinato"
	help
	  this is enables Sensorhub for rinato
if SENSORS_SSP_STM_RINATO
source "drivers/sensorhub/stm_rinato/Kconfig"
endif

endmenu
```

## drivers/sensors/Kconfig
```kconfig
menu "Sensor Drivers"

config SENSORS_CORE
        bool "Sensor Core"
        help
          Say Y here, and a list of sensors drivers will be displayed.
          Everything that didn't fit into the other categories is here. This option
          doesn't affect the kernel.

          If unsure, say Y.

if SENSORS_CORE

config SENSORS_MAX86902
	tristate "MAXIM MAX86902 HRM & UV Sensor"
	depends on I2C && OF
	select SENSORS_MAX_NOTCHFILTER
	help
	  If you say yes here you get support for the MAX86902
	  HRM & UV sensor.
	  This driver can also be built as a module.    If so, the module
	  will be called max86902.

config SENSORS_SSP
	tristate "Sensors ssp"
	default n
	depends on SPI
	help
	  ssp driver for sensor hub.
          If you say yes here you get ssp support for
	  sensor hub.
	  To compile this driver as a module, choose M here: the
	  module will be called ssp.

config SENSORS_SSP_SENSORHUB
	tristate "Sensors ssp sensorhub"
	default n
	depends on SPI
	help
	  ssp sensor hub driver for sensor hub.
          If you say yes here you get ssp support for
	  sensor hub.
	  To compile this driver as a module, choose M here: the
	  module will be called ssp.

config SENSORS_MAX_NOTCHFILTER
	bool "Sensors Maxim Notch Filter"
	help
	  Max Notch filter file for HR test in sensor driver.
	  If you say yes here you get Notch Filter support for
	  HR test.
	  To compile this driver as a module, choose M here: the
	  module will be called Max86902.

config SENSORS_SSP_BBD_BRCM
	bool "Sensorhub for BRCM"
	help
	  This is enables Sensorhub for BRCM
if SENSORS_SSP_BBD_BRCM
source "drivers/sensors/brcm/Kconfig"
endif

endif
endmenu
```

## drivers/sensors/brcm/Kconfig
```kconfig
#
# sensor drivers configuration
#
config SENSORS_SSP_BBD
	tristate "Sensors ssp brcm"
	default n
	depends on SPI
	help
	  ssp driver for sensor hub.
	  If you say yes here you get ssp support for
	  sensor hub.
	  To compile this driver as a module, choose M here: the
	  module will be called ssp.

choice
	depends on SENSORS_SSP_BBD
	prompt "Choose BBDPL Version"
	default SENSORS_SSP_BBD_VER2

config SENSORS_SSP_BBD_VER1
	bool "bbdpl1"
	depends on SPI
	help
	  Sensorhub bbdpl version 1 for TM2(e).

config SENSORS_SSP_BBD_VER2
	bool "bbdpl2"
	depends on SPI
	help
	  Sensorhub bbdpl version 2 for TM2(e).
endchoice

if SENSORS_SSP_BBD_VER2
source "drivers/sensors/brcm/bbdpl2/Kconfig"
endif

choice
    depends on SENSORS_SSP_BBD
    prompt "Choose target patch"
    default SENSORHUB_TM2

config SENSORHUB_S333
	bool "BROADCOM_SENSORHUB_S333"
	help
	  Support for BRCM S333

config SENSORHUB_TM2
	bool "BROADCOM_SENSORHUB_TM2"
	help
	  Support for BRCM TM2
endchoice

config SENSORS_SSP_ICM20610
	tristate "Sensors ssp icm20610"
	default n
	depends on SPI
	help
	  icm20610 file for factory test in ssp driver.
	  If you say yes here you get icm20610 support for
	  factory test.
	  To compile this driver as a module, choose M here: the
	  module will be called ssp.

config SENSORS_SSP_YAS532
	tristate "Sensors ssp yas532"
	default n
	depends on SPI
	help
	  yas532 file for factory test in ssp driver.
	  If you say yes here you get yas532 support for
	  factory test.
	  To compile this driver as a module, choose M here: the
	  module will be called ssp.

config SENSORS_SSP_BMP182
	tristate "Sensor ssp bmp182"
	default n
	depends on SPI
	help
	  bmp182 file for factory test in ssp driver.
	  If you say yes here you get lps25h support for
	  factory test.
	  To compile this driver as a module, choose M here: the
	  module will be called ssp.

config SENSORS_SSP_TMG399X
	tristate "Sensors ssp tmg399x"
	default n
	depends on SPI
	help
	  max88005 file for factory test in ssp driver.
	  If you say yes here you get tmg399x support for
	  factory test.
	  To compile this driver as a module, choose M here: the
	  module will be called ssp.

config SENSORS_SSP_MOBEAM
	tristate "Sensors ssp mobeam"
	default n
	depends on I2C
	help
	  mobeam file for ssp driver.
	  If you say yes here you get mobeam support using TMG399x.
	  To compile this driver as a module, choose M here: the
	  module will be called ssp.

config GPS_BCM47531
	bool "BROADCOM_GPS_CHIPSET_47531"
	default n
```

## drivers/sensors/brcm/gps/Kconfig
```kconfig
menu "Broadcom GPS Drivers"

config GPS_BCM47531
	bool "BROADCOM_GPS_CHIPSET_47531"
	select SEC_SYSFS
	default n
endmenu
```

## drivers/sensors/stm_rinato/Kconfig
```kconfig
#
# sensor drivers configuration
#
config SENSORS_SSP_STM
	tristate "Sensors ssp stm"
	default n
	depends on SPI
	help
	  ssp driver for sensor hub.
          If you say yes here you get ssp support for
	  sensor hub.
	  To compile this driver as a module, choose M here: the
	  module will be called ssp.

config SENSORS_SSP_MPU6500
	tristate "Sensors ssp mpu6500"
	default n
	depends on SPI
	help
	  mpu6500 file for factory test in ssp driver.
          If you say yes here you get mpu6500 support for
	  factory test.
	  To compile this driver as a module, choose M here: the
	  module will be called ssp.

config SENSORS_SSP_AK09911
	tristate "Sensors ssp ak09911"
	default n
	depends on SPI
	help
	  ak09911 file for factory test and doeplus in ssp driver.
          If you say yes here you get ak09911 support for
	  factory test.
	  To compile this driver as a module, choose M here: the
	  module will be called ssp.

config SENSORS_SSP_CM3320
	tristate "Sensors ssp cm3320"
	default n
	depends on SPI
	help
	  cm3320 file for factory test in ssp driver.
          If you say yes here you get cm3320 support for
	  factory test.
	  To compile this driver as a module, choose M here: the
	  module will be called ssp.

config SENSORS_SSP_MAX88920
	tristate "Sensors ssp max88920"
	default n
	depends on SPI
	help
	  max88920 file for factory test in ssp driver.
          If you say yes here you get max88920 support for
	  factory test.
	  To compile this driver as a module, choose M here: the
	  module will be called ssp.

config SENSORS_SSP_MAX88921
	tristate "Sensors ssp max88921"
	default n
	depends on SPI
	help
	  max88921 file for factory test in ssp driver.
          If you say yes here you get max88921 support for
	  factory test.
	  To compile this driver as a module, choose M here: the
	  module will be called ssp.

config SENSORS_SSP_LPS25H
	tristate "Sensors ssp lps25h"
	default n
	depends on SPI
	help
	  lps25h file for factory test in ssp driver.
          If you say yes here you get lps25h support for
	  factory test.
	  To compile this driver as a module, choose M here: the
	  module will be called ssp.

config SENSORS_SSP_ADPD142
	tristate "Sensors ssp adpd142"
	default n
	depends on SPI
	help
	  adpd142 file for factory test in ssp driver.
          If you say yes here you get adpd142 support for
	  factory test.
	  To compile this driver as a module, choose M here: the
	  module will be called ssp.

config SENSORS_SSP_STM32F401
	tristate "Sensors ssp stm32f401"
	default n
	depends on SPI
	help
	  stm32f401 file for factory test in ssp driver.
          If you say yes here you get stm32f401 support for
	  factory test.
	  To compile this driver as a module, choose M here: the
	  module will be called ssp.
```

## drivers/soc/samsung/Kconfig
```kconfig
#
# SAMSUNG SoC drivers
#
menuconfig SOC_SAMSUNG
	bool "Samsung SoC driver support" if COMPILE_TEST

if SOC_SAMSUNG

config EXYNOS_ASV
	bool "Exynos Adaptive Supply Voltage support" if COMPILE_TEST
	depends on ARCH_EXYNOS || ((ARM || ARM64) && COMPILE_TEST)
	depends on EXYNOS_CHIPID
	select EXYNOS_ASV_ARM if ARM && ARCH_EXYNOS
	select EXYNOS_ASV_ARM64 if ARM64 && ARCH_EXYNOS && MTD

# There is no need to enable these drivers for ARMv8
config EXYNOS_ASV_ARM
	bool "Exynos ASV ARMv7-specific driver extensions" if COMPILE_TEST
	depends on EXYNOS_ASV

# There is no need to enable these drivers for ARMv7
config EXYNOS_ASV_ARM64
	bool "Exynos ASV ARMv8-specific driver extensions" if COMPILE_TEST
	depends on EXYNOS_ASV

config EXYNOS_CHIPID
	bool "Exynos Chipid controller driver" if COMPILE_TEST
	depends on ARCH_EXYNOS || COMPILE_TEST
	select SOC_BUS

config EXYNOS_PMU
	bool "Exynos PMU controller driver" if COMPILE_TEST
	depends on ARCH_EXYNOS || ((ARM || ARM64) && COMPILE_TEST)
	select EXYNOS_PMU_ARM_DRIVERS if ARM && ARCH_EXYNOS
	select EXYNOS_PMU_ARM64_DRIVERS if ARM64 && ARCH_EXYNOS

# There is no need to enable these drivers for ARMv8
config EXYNOS_PMU_ARM_DRIVERS
	bool "Exynos PMU ARMv7-specific driver extensions" if COMPILE_TEST
	depends on EXYNOS_PMU

# There is no need to enable these drivers for ARMv7
config EXYNOS_PMU_ARM64_DRIVERS
	bool "Exynos PMU ARMv8-specific driver extensions" if COMPILE_TEST
	depends on EXYNOS_PMU

config EXYNOS_PM_DOMAINS
	bool "Exynos PM domains" if COMPILE_TEST
	depends on PM_GENERIC_DOMAINS || COMPILE_TEST

endif
```

## drivers/staging/android/Kconfig
```kconfig
menu "Android"

if ANDROID

config ASHMEM
	bool "Enable the Anonymous Shared Memory Subsystem"
	default n
	depends on SHMEM
	---help---
	  The ashmem subsystem is a new shared memory allocator, similar to
	  POSIX SHM but with different behavior and sporting a simpler
	  file-based API.

	  It is, in theory, a good memory allocator for low-memory devices,
	  because it can discard shared memory units when under memory pressure.

config ANDROID_LOGGER
	tristate "Android log driver"
	default n
	---help---
	  This adds support for system-wide logging using four log buffers.

	  These are:

	      1: main
	      2: events
	      3: radio
	      4: system

	  Log reading and writing is performed via normal Linux reads and
	  optimized writes. This optimization avoids logging having too
	  much overhead in the system.

config ANDROID_LOW_MEMORY_KILLER
	bool "Android Low Memory Killer"
	---help---
	  Registers processes to be killed when low memory conditions, this is useful
	  as there is no particular swap space on android.

	  The registered process will kill according to the priorities in android init
	  scripts (/init.rc), and it defines priority values with minimum free memory size
	  for each priority.

config ANDROID_LOW_MEMORY_KILLER_AUTODETECT_OOM_ADJ_VALUES
	bool "Android Low Memory Killer: detect oom_adj values"
	depends on ANDROID_LOW_MEMORY_KILLER
	default y
	---help---
	  Detect oom_adj values written to
	  /sys/module/lowmemorykiller/parameters/adj and convert them
	  to oom_score_adj values.

config ANDROID_INTF_ALARM_DEV
	tristate "Android alarm driver"
	depends on RTC_CLASS
	default n
	---help---
	  Provides non-wakeup and rtc backed wakeup alarms based on rtc or
	  elapsed realtime, and a non-wakeup alarm on the monotonic clock.
	  Also exports the alarm interface to user-space.

config SUPPORT_ALARM_TIMEZONE_DST
	bool "Alarm manager support timezone and dst"
	default n
	---help---
	 Support timezone and dst from user space.
         Alarm manager give us timezone and dst time

config ALARM_HISTORY
	tristate "Alarm history"
	depends on ANDROID_INTF_ALARM_DEV
	default n
	---help---
	  Provides logging function which process used alarm.

source "drivers/staging/android/ion/Kconfig"
source "drivers/staging/android/switch/Kconfig"

source "drivers/staging/android/fiq_debugger/Kconfig"

endif # if ANDROID

endmenu
```

## drivers/staging/nanohub/Kconfig
```kconfig
config CONTEXTHUB
	tristate "Contexthub"
	default N
	help
	  Enable support for the contexthub driver.

config NANOHUB
	tristate "Nanohub"
	default N
	select IIO
	select CONTEXTHUB
	help
	  Enable support for the nanohub sensorhub driver.

	  This driver supports the android nanohub sensorhub.

	  If in doubt, say N here.

config CONTEXTHUB_DRV
	tristate "Contexthub driver"
	default N
	select CONTEXTHUB
	select CONTEXTHUB_IPC
	help
	  Enable support for legacy contexthub driver.

config CONTEXTHUB_IPC
	tristate "contexthub IPC driver"
	default N
	help
	  Enable support for the IPC between AP and contexthub.

config CONTEXTHUB_DEBUG
	bool "Contexthub debug"
	default y
	depends on CONTEXTHUB_IPC
	help
	  Eanble nanohub device debug message

if NANOHUB

config NANOHUB_SPI
	bool "Nanohub SPI"
	default N
	help
	  Enable nanohub SPI support.

	  Either this or NANOHUB_I2C should be selected.

	  If in doubt, say Y here.

config NANOHUB_I2C
	bool "Nanohub I2C"
	default N
	help
	  Enable nanohub I2C support.

	  Either this or NANOHUB_SPI should be selected.

	  If in doubt, say N here.

config NANOHUB_MAILBOX
	bool "Nanohub Mailbox"
	default Y
	select CONTEXTHUB_IPC
	help
	  Enable nanohub Mailbox support.

	  Either this or NANOHUB_MAILBOX should be selected.

	  If in doubt, say N here.

endif # NANOHUB
```
