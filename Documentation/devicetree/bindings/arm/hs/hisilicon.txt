## Documentation/devicetree/bindings/mfd/max77843.txt
```
Maxim MAX77843 multi-function device

MAX77843 is a Multi-Function Device with the following submodules:
- PMIC	  : 2 SAFEOUT LDOs for USB device
- CHARGER : Li+ battery charger with Fuel Gauge
- MUIC	  : Micro USB Interface Controller
- HAPTIC  : Motor Controller for tactile feedback

It is interfaced to host controller using I2C.

Required properties:
- compatible : Must be "maxim,max77843".
- reg : I2C slave address of PMIC block.
- interrupts : I2C line for main SoCs.
- interrupt-parent : The parent of interrupt controller.

Optional properties:
- regulators : The regulators of max77843 have to be instantiated under subnode
	named "regulators" using the following format.

	[*]refer : Documentation/devicetree/bindings/regulator/regulator.txt

	regulators {
		SAFEOUT {
			regulator-name = "SAFEOUT";
		};
	}

	List of valid regulator names:
	- SAFEOUT1, SAFEOUT2, CHARGER.

- max77843-muic : This properties used by extcon consumers.
	Required properties:
		- compatible : Must be "maxim,max77842-muic".

- max77843-charger : There battery charger of MAX77843 have to be instantiated
	under sub-node named "max77843-charger" using the following format.
	Required properties:
		- compatible : Must be "maxim,max77842-charger".
		- maxim,fast-charge-uamp : Fast charge current levels are
			100 mA to 3150 mA programmed by I2C per 100 mA.
		- maxim,top-off-uamp : Top off current threshold levels are
			125 mA to 650 mA programmed by I2C per 75 mA.
		- maxim,input-uamp-limit : Input current limit levels are
			100 mA to 3533 mA programmed by I2C per 33 mA.

- max77843-fuelgauge : There fuelgauge of MAX77843 have to be instantiated
	under sub-node named "max77843-fuelgauge" using the following format.
	Required properties:
		- compatible : Must be "maxim,max77842-fuelgauge".

- max77843-haptic : The MAX77843 haptic device provides the tactile feedback
	to the user by using PWM(Pulse Width Modulation) signal.
	Required properties:
		- compatible : Must be "maxim,max77843-hpatic".
		- haptic-supply : Power supply for the haptic motor.
			[*] refer Documentation/devicetree/
					bindings/regulator/regulator.txt
		- pwms : phandle for the PWM(Pulse Width Modulation) device.
			PWM properties should be named "pwms".
			[*] refer Documentation/devicetree/bindings/pwm/pwm.txt

Example:
	max77843@66 {
		compatible = "samsung,max77843";
		reg = <0x66>;
		interrupt-parent = <&gpa1>;
		interrupts = <5 2>;

		regulators {
			SAFEOUT1 {
				regulator-name = "SAFEOUT1";
				regulator-min-microvolt = <3300000>;
				regulator-max-microvolt = <4950000>;
			};
			SAFEOUT2 {
				regulator-name = "SAFEOUT2";
				regulator-min-microvolt = <3300000>;
				regulator-max-microvolt = <4950000>;
			};
			CHARGER {
				regulator-name = "CHARGER";
				regulator-min-microamp = <100000>;
				regulator-max-microamp = <3150000>;
			};
		};

		haptic {
			compatible = "maxim,max77843-haptic";
			haptic-supply = <&haptic_supply>;
			pwms = <&pwm 0 40000 0>;
			pwm-names = "haptic";
		};

		max77843-muic {
			compatible = "maxim,max77843-muic";
		};

		max77843-charger {
			compatible = "maxim,max77843-charger";
			maxim,fast-charge-uamp = <450000>;
			maxim,top-off-uamp = <125000>;
			maxim,input-uamp-limit = <500000>;
		};

		max77843-fuelgauge {
			compatible = "maxim,max77843-fuelgauge";
		};

	};
```

## Documentation/devicetree/bindings/mmc/k3-dw-mshc.txt
```
* Hisilicon specific extensions to the Synopsis Designware Mobile
  Storage Host Controller

Read synopsis-dw-mshc.txt for more details
The Synopsis designware mobile storage host controller is used to interface
a SoC with storage medium such as eMMC or SD/MMC cards. This file documents
differences between the core Synopsis dw mshc controller properties described
by synopsis-dw-mshc.txt and the properties used by the Hisilicon specific
extensions to the Synopsis Designware Mobile Storage Host Controller.

Required Properties:

* compatible: should be
	- "hisilicon,hi4511-dw-mshc": for controllers with hi4511
	  specific extentions.
* vmmc-supply: should be vmmc used in dwmmc
* fifo-depth: should be provided if register can not provide correct value
* clken-reg: should be clock enable register and offset
* drv-sel-reg: should be driver delay select register and offset
* sam-sel-reg: should be sample delay select register and offset
* div-reg: should be divider register and offset

Example:

  The MSHC controller node can be split into two portions, SoC specific and
  board specific portions as listed below.

	dwmmc_0: dwmmc0@fcd03000 {
		compatible = "hisilicon,hi4511-dw-mshc";
		reg = <0xfcd03000 0x1000>;
		interrupts = <0 16 4>;
		#address-cells = <1>;
		#size-cells = <0>;
		clocks = <&clk_sd>, <&clk_ddrc_per>;
		clock-names = "ciu", "biu";
		clken-reg = <0x1f8 0>;
		drv-sel-reg = <0x1f8 4>;
		sam-sel-reg = <0x1f8 8>;
		div-reg = <0x1f8 1>;
	};
	dwmmc0@fcd03000 {
		num-slots = <1>;
		vmmc-supply = <&ldo12>;
		fifo-depth = <0x100>;
		supports-highspeed;
		pinctrl-names = "default";
		pinctrl-0 = <&sd_pmx_pins &sd_cfg_func1 &sd_cfg_func2>;
		cd-gpio = <&gpio10 3 0>;
		slot@0 {
			reg = <0>;
			bus-width = <4>;
		};
	};

PCTRL:

Required Properties:
* compatible: should be
	- "hisilicon,pctrl": Peripheral control

Example:

	pctrl: pctrl@fca09000 {
		compatible = "hisilicon,pctrl";
		reg = <0xfca09000 0x1000>;
	};
```

## Documentation/devicetree/bindings/net/wireless/brcm,bcm43xx-fmac.txt
```
Broadcom BCM43xx-series FullMAC WLAN network adapter

Required properties:
- compatible: should be one of following:
  - "brcm,bcm43143" - for BCM43134 chip,
  - "brcm,bcm4324" - for BCM4324 chip,
  - "brcm,bcm4329" - for BCM4329 chip,
  - "brcm,bcm4330" - for BCM4330 chip,
  - "brcm,bcm4334" - for BCM4334 chip,
  - "brcm,bcm4335" - for BCM4335 chip.
- wlan-supply: regulator used to control power of WLAN block of the chip.

Optional properties:
- interrupt-parent: interrupt controller to which the out-of-bound interrupt
    signal of the chip (usually WL_HOST_WAKE pin) is connected.
- interrupts: interrupt specifier of the out-of-bound interrupt in format
    specific to interrupt controller specifiedy by interrupt-parent property.
- clock-names: Should contain one clock entry - "32khz", which is the external
    32768 Hz clock used by the chip.
- clocks: Clock specifiers given in the same order as specified in clock-names
    property.

Example:

	wlan_reg: voltage-regulator {
		compatible = "regulator-fixed";
		regulator-name = "WL_REG_ON";
		regulator-min-microvolt = <1800000>;
		regulator-max-microvolt = <1800000>;
		gpio = <&gpj0 0 0>;
		enable-active-high;
	};

	wlan {
		compatible = "brcm,bcm4334";
		wlan-supply = <&wlan_reg>;
		interrupt-parent = <&gpx2>;
		interrupts = <5 4>;
		clocks = <&max77686 2>;
		clock-names = "32khz";
	};
```

## Documentation/devicetree/bindings/panel/samsung,s6e3ha2.txt
```
Samsung S6E3HA2 5.7" 1440x2560 AMOLED panel

Required properties:
  - compatible: "samsung,s6e3ha2"
  - reg: the virtual channel number of a DSI peripheral
  - vdd3-supply: core voltage supply
  - vci-supply: voltage supply for analog circuits
  - reset-gpios: a GPIO spec for the reset pin
  - panel-en-gpios: a GPIO spec for the panel enable pin
  - te-gpios: a GPIO spec for the tearing effect synchronization signal gpio pin

Optional properties:
  - display-timings: timings for the connected panel as described by [1]
  - panel-width-mm: physical panel width [mm]
  - panel-height-mm: physical panel height [mm]

The device node can contain one 'port' child node with one child
'endpoint' node, according to the bindings defined in [2]. This
node should describe panel's video bus.

[1]: Documentation/devicetree/bindings/video/display-timing.txt
[2]: Documentation/devicetree/bindings/media/video-interfaces.txt

Example:

panel@0 {
	compatible = "samsung,s6e3ha2";
	reg = <0>;
	vdd3-supply = <&ldo27_reg>;
	vci-supply = <&ldo28_reg>;
	reset-gpios = <&gpg0 0 0>;
	panel-en-gpios = <&gpf1 5 0>;
	te-gpios = <&gpf1 3 1>;
	panel-width-mm = <71>;
	panel-height-mm = <125>;

	display-timings {
		timing-0 {
			clock-frequency = <0>;
			hactive = <1440>;
			vactive = <2560>;
			hfront-porch = <1>;
			hback-porch = <1>;
			hsync-len = <1>;
			vfront-porch = <1>;
			vback-porch = <15>;
			vsync-len = <1>;
		};
	};
```

## Documentation/devicetree/bindings/phy/samsung-usbphy.txt
```
Samsung S5P/EXYNOS SoC series USB PHY
-------------------------------------------------

Required properties:
- compatible : should be one of the listed compatibles:
	- "samsung,exynos4210-usbphy"
	- "samsung,exynos4212-usbphy"
- reg : a list of registers used by phy driver
	- first and obligatory is the location of phy modules registers
	- second and also required is the location of isolation registers
	  (isolation registers control the physical connection between the in
	  SoC modules and outside of the SoC, this also can be called enable
	  control in the documentation of the SoC)
	- third is the location of the mode switch register, this only applies
	  to SoCs that have such a feature; mode switching enables to have
	  both host and device used the same SoC pins and is commonly used
	  when OTG is supported
- #phy-cells : from the generic phy bindings, must be 1;

The second cell in the PHY specifier identifies the PHY its meaning is SoC
dependent. For the currently supported SoCs (Exynos 4210 and Exynos 4212) it
is as follows:
  0 - USB device,
  1 - USB host,
  2 - HSIC0,
  3 - HSIC1,

Example:

For Exynos 4412 (compatible with Exynos 4212):

exynos_usbphy: exynos-usbphy@125B0000 {
	compatible = "samsung,exynos4212-usbphy";
	reg = <0x125B0000 0x100 0x10020704 0x0c 0x1001021c 0x4>;
	ranges;
	#address-cells = <1>;
	#size-cells = <1>;
	clocks = <&clock 305>, <&clock 2>, <&clock 2>, <&clock 2>,
							<&clock 2>;
	clock-names = "phy", "device", "host", "hsic0", "hsic1";
	status = "okay";
	#phy-cells = <1>;
};

Then the PHY can be used in other nodes such as:

ehci@12580000 {
	status = "okay";
	phys = <&exynos_usbphy 2>;
	phy-names = "hsic0";
};
```

## Documentation/devicetree/bindings/pwm/bcm-kona-pwm.txt
```
Broadcom's PWM Controller Device Tree bindings

Broadcom's Kona PWM Controller has 6 channels

Required Properties :
- compatible: should be "brcm,kona-pwm"
- reg: physical base address and length of the controller's registers
- clocks: clock specifier for the kona pwm external clock
- #pwm-cells: should be 2.  The first cell specifies the per-chip index
  of the PWM to use and the second cell is the period in nanoseconds.

Refer to pwm/pwm.txt for generic pwm controller node properties.

Refer to clocks/clock-bindings.txt for generic clock consumer
properties

Example:

pwm: pwm@3e01a000 {
	compatible = "brcm,bcm11351-pwm", "brcm,kona-pwm";
	reg = <0x3e01a000 0xc4>;
	clocks = <&pwm_clk>;
	#pwm-cells = <2>;
};
```

## Documentation/devicetree/bindings/sound/samsung,odroidx2-max98090.txt
```
Samsung OdroidX2/U3 audio complex

Required properties:
 - compatible : "samsung,odroidx2-audio" - for odroidx2 board,
		"samsung,odroidu3-audio" - for odroidu3 board
 - samsung,model : the user-visible name of this sound complex.
 - samsung,i2s-controller : the phandle of the I2S controller
 - samsung,audio-codec : the phandle of the MAX98090 audio codec
 - samsung,audio-routing : a list of the connections between audio
   components;  each entry is a pair of strings, the first being the
   connection's sink, the second being the connection's source;
   valid names for sources and sinks are the MAX98090's pins (as
   documented in its binding), and the jacks on the board;
   For Odroid X2:
     * Headphone Jack
     * Mic Jack
     * DMIC

   For Odroid U3:
     * Headset Stereophone
     * Speakers
     * Headset Mic

Example:

sound {
	compatible = "samsung,odroidx2-audio";
	samsung,i2s-controller = <&i2s0>;
	samsung,audio-codec = <&max98090>;
};
```

## Documentation/devicetree/bindings/sound/samsung-exynos4-wm1811.txt
```
Samsung Exynos4 audio complex

Required properties:

- compatible : "samsung,exynos4-wm1811";
- samsung,model : the user-visible name of this sound complex;
- samsung,audio-routing : A list of the connections between audio components.
  Each entry is a pair of strings, the first being the connection's sink,
  the second being the connection's source. Valid names for sources and
  sinks are the WM8903's pins, and the jacks on the board:

  ...

  * Headphone Jack
  * Int Spk
  * Mic Jack

- samsung,i2s-controller : the phandle of the Tegra I2S1 controller;
- samsung,audio-codec : the phandle of the WM8903 audio codec.

Optional properties:
- nvidia,spkr-en-gpios : The GPIO that enables the speakers;
- nvidia,hp-mute-gpios : The GPIO that mutes the headphones;
- nvidia,hp-det-gpios : The GPIO that detect headphones are plugged in;
- nvidia,int-mic-en-gpios : The GPIO that enables the internal microphone;
- nvidia,ext-mic-en-gpios : The GPIO that enables the external microphone.

Example:

sound {
	compatible = "samsung,exynos-wm1811";
	nvidia,model = "redwood-wm1811";

	samsung,audio-routing =
		"Headphone Jack", "HPOUTR",
		"Headphone Jack", "HPOUTL",
		"IN1L", "Mic Jack";

	samsung,i2s-controller = <&i2s0>;
	samsung,audio-codec = <&wm1811>;

	nvidia,spkr-en-gpios = <&codec 2 0>;
	nvidia,int-mic-en-gpios = <&gpio 184 0>; /*gpio PX0 */
	nvidia,ext-mic-en-gpios = <&gpio 185 0>; /* gpio PX1 */
};
```

## Documentation/devicetree/bindings/sound/samsung-i2s.txt
```
* Samsung I2S controller

Required SoC Specific Properties:

- compatible : should be one of the following.
   - samsung,s3c6410-i2s: for 8/16/24bit stereo I2S.
   - samsung,s5pv210-i2s: for 8/16/24bit multichannel(5.1) I2S with
     secondary fifo, s/w reset control and internal mux for root clk src.

- reg: physical base address of the controller and length of memory mapped
  region.
- interrupts: should contain I2S interrupt number.
- dmas: list of DMA controller phandle and DMA request line ordered pairs.
- dma-names: identifier string for each DMA request line in the dmas property.
  These strings correspond 1:1 with the ordered pairs in dmas.

Optional SoC Specific Properties:

- samsung,idma-addr: Internal DMA register base address of the audio
  sub system(used in secondary sound source).
- samsung,no-muxpsr: IISMOD does not have RCLK clock source selection bit.

Required Board Specific Properties:

- gpios: The gpio specifier for data out,data in, LRCLK, CDCLK and SCLK
  interface lines. The format of the gpio specifier depends on the gpio
  controller.
  The syntax of samsung gpio specifier is
	<[phandle of the gpio controller node]
	 [pin number within the gpio controller]
	 [mux function]
	 [flags and pull up/down]
	 [drive strength]>

Example:

- SoC Specific Portion:

i2s@03830000 {
	compatible = "samsung,s5pv210-i2s";
	reg = <0x03830000 0x100>;
	interrupts = <0 97 0>;
	dmas = <&pdma0 10
		&pdma0 9
		&pdma0 8>;
	dma-names = "tx", "rx", "tx-sec";
	samsung,idma-addr = <0x03000000>;
};

- Board Specific Portion:

i2s@03830000 {
	gpios = <&gpz 0 2 0 0>, /* I2S_0_SCLK */
		<&gpz 1 2 0 0>, /* I2S_0_CDCLK */
		<&gpz 2 2 0 0>, /* I2S_0_LRCK */
		<&gpz 3 2 0 0>, /* I2S_0_SDI */
		<&gpz 4 2 0 0>, /* I2S_0_SDO[1] */
		<&gpz 5 2 0 0>, /* I2S_0_SDO[2] */
		<&gpz 6 2 0 0>; /* I2S_0_SDO[3] */
};
```
