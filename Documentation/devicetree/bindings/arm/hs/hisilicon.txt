## Documentation/devicetree/bindings/arm/hs/hisilicon.txt
```
Hisilicon Platforms Device Tree Bindings
----------------------------------------------------

Hi3716 Development Board
Required root node properties:
	- compatible = "hisilicon,hi3716-dkb";

Hi4511 Board
Required root node properties:
	- compatible = "hisilicon,hi3620-hi4511";
```

## Documentation/devicetree/bindings/arm/samsung/exynos-chipid.txt
```
SAMSUNG Exynos SoC series CHIPID subsystem

Required properties:
- compatible : Should at least contain "samsung,exynos4210-chipid";
  For Exynos5433 SoC should also contain "samsung,exynos5433-chipid".

- reg: Offset and length of the register set. For "samsung,exynos5433-chipid"
  compatible this property should contain at least two entries, i.e. it should
  describe two IO register regions, where the second one corresponds to
  the ABB registers region.

Example:
	chipid@10000000 {
		compatible = "samsung,exynos4210-chipid";
		reg = <0x10000000 0x100>;
	};
```

## Documentation/devicetree/bindings/clock/exynos4-audss-clock.txt
```
* Samsung Exynos4 Audio Subsystem Clock Controller

The Exynos4 Audio Subsystem clock controller generates and supplies clocks
to Audio Subsystem block available in the Exynos4 SoCs. The clock binding
described here is applicable to all SoC's in the Exynos4 family.


Required Properties:

- comptible: should be one of the following.
  - "samsung,exynos4-audss-clock" - controller compatible with all Exynos4 SoCs.

- reg: physical base address of the controller and length of memory mapped
  region.

- #clock-cells: should be 1.

The following is the list of clocks generated by the controller. Each clock is
assigned an identifier and client nodes use this identifier to specify the
clock which they consume. Some of the clocks are available only on a particular
Exynos4 SoC and this is specified where applicable.


Provided clocks:

	Clock		ID	SoC (if specific)
	-----------------------------------------------

	mout_audss	0
	dout_rp		1
	dout_aud_bus	2
	mout_i2s	3
	dout_i2sclk0	4
	clk_i2s0	5
	clk_pcm0	6


Example 1: An example of a clock controller node is listed below.

	clock_audss: clock-controller@03810000 {
		compatible = "samsung,exynos4-audss-clock";
		reg = <0x03810000 0x0C>;
		#clock-cells = <1>;
	};

Example 2: I2S controller node that consumes the clock generated by the clock
	   controller. Refer to the standard clock bindings for information
	   about 'clocks' and 'clock-names' property.

	i2s0: i2s@03830000 {
		compatible = "samsung,i2s-v5";
		reg = <0x03830000 0x100>;
		clocks = <&clock_audss 0>, <&clock_audss 3>, <&clock_audss 1>,
			<&clock_audss 2>, <&clock_audss 4>, <&clock_audss 2>;
		clock-names = "mout_audss", "mout_i2s", "dout_srp",
			"dout_bus", "dout_i2s", "i2s_opclk0";
	};
```

## Documentation/devicetree/bindings/cpufreq/cpufreq-dt.txt
```
Generic cpufreq driver

It is a generic DT based cpufreq driver for frequency management.  It supports
both uniprocessor (UP) and symmetric multiprocessor (SMP) systems which share
clock and voltage across all CPUs.

Both required and optional properties listed below must be defined
under node /cpus/cpu@0.

Required properties:
- None

Optional properties:
- operating-points: Refer to Documentation/devicetree/bindings/power/opp.txt for
  details. OPPs *must* be supplied either via DT, i.e. this property, or
  populated at runtime.
- boost-opps: Certain CPUs can be operated in optional 'boost' mode (sometimes
  also referred as overclocking) in which the CPU can operate at frequencies
  which are not specified by the manufacturer as CPU's operating frequency.
  CPU usually can operate in 'boost' mode for limited amount of time which
  depends on thermal conditions.  This makes the boost operating points
  separate from normal ones which can be used at any time.  This property
  consists of an array of 2-tuples items, and each item consists of frequency
  and voltage like <freq-kHz vol-uV>.
	freq: clock frequency in kHz
	vol: voltage in microvolt
- clock-latency: Specify the possible maximum transition latency for clock,
  in unit of nanoseconds.
- voltage-tolerance: Specify the CPU voltage tolerance in percentage.
- #cooling-cells:
- cooling-min-level:
- cooling-max-level:
     Please refer to Documentation/devicetree/bindings/thermal/thermal.txt.

Examples:

cpus {
	#address-cells = <1>;
	#size-cells = <0>;

	cpu@0 {
		compatible = "arm,cortex-a9";
		reg = <0>;
		next-level-cache = <&L2>;
		operating-points = <
			/* kHz    uV */
			792000  1100000
			396000  950000
			198000  850000
		>;
		boost-opps = <
			/* kHz    uV */
			891000  1150000
		>;
		clock-latency = <61036>; /* two CLK32 periods */
		#cooling-cells = <2>;
		cooling-min-level = <0>;
		cooling-max-level = <2>;
	};

	cpu@1 {
		compatible = "arm,cortex-a9";
		reg = <1>;
		next-level-cache = <&L2>;
	};

	cpu@2 {
		compatible = "arm,cortex-a9";
		reg = <2>;
		next-level-cache = <&L2>;
	};

	cpu@3 {
		compatible = "arm,cortex-a9";
		reg = <3>;
		next-level-cache = <&L2>;
	};
};
```

## Documentation/devicetree/bindings/devfreq/exynos-bus.txt
```
* Generic Exynos Memory Bus device

The Samsung Exynos SoCs have many memory buses for data transfer between DRAM
memory and MMC/sub-IP in SoC. Almost Exynos SoCs have the common architecture
for memory buses. Generally, Exynos SoC express the memory bus by using memory
bus group and block. The memory bus group has one more memory bus blocks and
OPP table (including frequency and voltage for DVFS), regulator, devfreq-event
devices. Each memory bus block has a clock for own memory bus speen and
frequency table for DVFS. There are a little different among Exynos SoCs
because each Exynos SoC has the different sub-IP and differnt memory bus.
So, this difference should be specified in devicetree file.

Required properties for memory bus group:
- compatible: Should be "samsung,exynos-memory-bus".
- operating-points: the OPP table including frequency/voltage information to
                  support DVFS (Dynamic Voltage/Frequency Scaling) feature.
- devfreq-events: the devfreq-event device to monitor the curret state of
                  memory bus group.
- vdd-mem-supply: the regulator to provide memory bus group with the voltage.

Optional properties for memory bus group:
- exynos,saturation-ratio: the percentage value which is used to calibrate
                   the memory performance count againt memory cycle count.

Required properties for memory bus block:
- clock-names : the name of clock used by the memory bus, "memory-bus".
- clocks : phandles for clock specified in "clock-names" property.
- #clock-cells: should be 1.
- frequency: the frequency table to support DVFS feature.

Example1:
	Show the hierarchy of Exynos3250 Memory Bus group. Exynos3250 divides
	the memory bus group according to power rail (regulator). Each memory
	bus group contains only one power rial and one more memory bus blocks.
	- MIF (Memory Interface) Memory bus group uses the VDD_MIF regulator
	  and has only one DMC (Dynamic Memory Controller) memory bus block
	  as following:
				|
	power rail(VDD_MIF)---->|-> memory bus for DMC blk (dmc clock)
				|

	- INT (Internal) memory Memory bus group uses the VDD_INT regulator and
	  has eight memory bus blocks as following:
				|
				|-> memory bus for PERI blk (aclk_100)
				|-> memory bus for DISPLAY blk (aclk_160)
				|-> memory bus for ISP blk (aclk_200)
				|-> memory bus for GPS blk (aclk_266)
	power rail(VDD_INT)---->|
				|-> memory bus for MCUISP blk (aclk_400_mcuisp)
				|-> memory bus for Leftbus blk (div_gdl)
				|-> memory bus for Rightbus blk (div_gdr)
				|-> memory bus for MFC blk (sclk_mfc)
				|

	Make the table for two memory bus groups which include pair information
	of between 'Rate/Voltage' and the clock of each memory bus block.
	The 'Rate' is used in devfreq ondemand governor to decide the proper
	frequency of memory bus group and then exynos-bus.c driver change the
	clock rate of each memory bus block according to freq/voltage table.

	- MIF memory bus group's frequency/voltage table
	------------------------------
	|Lv|Rate   |div_dmc |Voltage |
	------------------------------
	|L5|400000 |100000  |875000  |
	|L4|200000 |200000  |800000  |
	|L3|133000 |133000  |800000  |
	|L2|100000 |100000  |800000  |
	|L1|50000  |80000   |800000  |
	------------------------------

	- INT memory bus group's frequency/voltage table
	--------------------------------------------------------------------
	|         |PERI  |Display|ISP   |GPS   |MCUISP|GDL   |GDR   |MFC   |
	--------------------------------------------------------------------
	|         |aclk  |aclk   |aclk  |aclk  |aclk  |div   |div_  |sclk  |
	|Lv|Rate  |  _100|  _160 |  _200|  _266|  _400|  _gdl|  _gdr|  _mfc|
	--------------------------------------------------------------------
	|L6|400000|100000|200000 |200000|300000|300000|200000|200000|200000|
	|L5|200000|100000|160000 |200000|200000|200000|200000|200000|200000|
	|L4|133000|100000|100000 |100000|133000|133000|133000|133000|200000|
	|L3|100000|100000|80000  |80000 |100000|100000|100000|100000|133000|
	|L2|80000 |50000 |80000  |50000 |50000 |50000 |100000|100000|100000|
	|L1|50000 |50000 |50000  |50000 |50000 |50000 |100000|100000|80000 |
	--------------------------------------------------------------------
	|Lv|Freq  |Voltage|
	-------------------
	|L6|400000|950000 |
	|L5|200000|950000 |
	|L4|133000|925000 |
	|L3|100000|850000 |
	|L2|80000 |850000 |
	|L1|50000 |850000 |
	------------------

Example2 :
	Memory bus group/block in exynos3250.dtsi are listed below.
	Exynos3250 has two memory bus group (MIF, INT group). MIF (Memory
	Interface) memory bus group includes one memory bus block between
	DRAM and eMMC. Also, INT (Internal) memory bus group includes eight
	memory bus blocks which support each sub-IP between DRAM and sub-IP.

	memory_bus_mif: memory_bus@0 {
		compatible = "samsung,exynos-memory-bus";

		operating-points = <
			400000 875000
			200000 800000
			133000 800000
			100000 800000
			50000  800000>;
		status = "disabled";

		blocks {
			dmc_block: memory_bus_block1 {
				clocks = <&cmu_dmc CLK_DIV_DMC>;
				clock-names = "memory-bus";
				frequency = <
					400000
					200000
					133000
					100000
					50000>;
			};
		};
	};

	memory_bus_int: memory_bus@1 {
		compatible = "samsung,exynos-memory-bus";

		operating-points = <
			400000 950000
			200000 950000
			133000 925000
			100000 850000
			80000  850000
			50000  850000>;

		status = "disabled";

		blocks {
			peri_block: memory_bus_block1 {
				clocks = <&cmu CLK_DIV_ACLK_100>;
				clock-names = "memory-bus";
				frequency = <
					100000
					100000
					100000
					100000
					50000
					50000>;
			};

			display_block: memory_bus_block2 {
				clocks = <&cmu CLK_DIV_ACLK_160>;
				clock-names = "memory-bus";
				frequency = <
					200000
					160000
					100000
					80000
					80000
					50000>;
			};

			isp_block: memory_bus_block3 {
				clocks = <&cmu CLK_DIV_ACLK_200>;
				clock-names = "memory-bus";
				frequency = <
					200000
					200000
					100000
					80000
					50000
					50000>;
			};

			gps_block: memory_bus_block4 {
				clocks = <&cmu CLK_DIV_ACLK_266>;
				clock-names = "memory-bus";
				frequency = <
					300000
					200000
					133000
					100000
					50000
					50000>;
			};

			mcuisp_block: memory_bus_block5 {
				clocks = <&cmu CLK_DIV_ACLK_400_MCUISP>;
				clock-names = "memory-bus";
				frequency = <
					400000
					200000
					50000
					50000
					50000
					50000>;
			};

			leftbus_block: memory_bus_block6 {
				clocks = <&cmu CLK_DIV_GDL>;
				clock-names = "memory-bus";
				frequency = <
					200000
					200000
					133000
					100000
					100000
					100000>;
			};

			rightbus_block: memory_bus_block7 {
				clocks = <&cmu CLK_DIV_GDR>;
				clock-names = "memory-bus";
				frequency = <
					200000
					200000
					133000
					100000
					100000
					100000>;
			};

			mfc_block: memory_bus_block8 {
				clocks = <&cmu CLK_SCLK_MFC>;
				clock-names = "memory-bus";
				frequency = <
					200000
					200000
					200000
					133000
					100000
					80000>;
			};
		};
	};

Example3 :
	Usage case to handle the frequency/voltage of memory bus on runtime
	in exynos3250-rinato.dts are listed below.

	&memory_bus_mif {
		devfreq-events = <&ppmu_dmc0_3>, <&ppmu_dmc1_3>;
		vdd-mem-supply = <&buck1_reg>;
		status = "okay";
	};

	&memory_bus_int {
		devfreq-events = <&ppmu_leftbus_3>, <&ppmu_rightbus_3>;
		vdd-mem-supply = <&buck3_reg>;
		status = "okay";
	};
```

## Documentation/devicetree/bindings/drm/exynos/samsung-rotator.txt
```
* Samsung Image Rotator

Required properties:
  - compatible : value should be the "samsung,exynos4210".
  - reg : Physical base address of the IP registers and length of memory
	  mapped region.
  - interrupts : interrupt number to the CPU.
  - clocks : clock number of exynos4 rotator clock.
  - clocks : clock name of rotator
  - status : "okay" or "disabled"
  - limit table for image formats : min_w/min_h/max_w/max_h for min/max of image

Example:
	rotator: rotator@12810000 {
		compatible = "samsung,exynos4210-rotator";
		reg = <0x12810000 0x1000>;
		interrupts = <0 83 0>;
		clocks = <&clock 278>;
		clock-names = "rotator";
		status = "disabled";
		ycbcr420_2p {
			min_w = <32>;
			min_h = <32>;
			max_w = <32768>;
			max_h = <32768>;
			align = <3>;
		};
		rgb888 {
			min_w = <8>;
			min_h = <8>;
			max_w = <8192>;
			max_h = <8192>;
			align = <2>;
		};
	};
```

## Documentation/devicetree/bindings/iio/barometer/lps331ap.txt
```
* STMicroelectronics LPS331AP barometer sensor

Required properties:

  - compatible : should be "st,lps331ap"
  - reg : the I2C address of the barometer

Optional properties:

  - interrupt-parent : phandle to the interrupt map subnode
  - interrupts : interrupt mapping for LPS331AP interrupt sources:
		 2 sources: 0 - INT1, 1 - INT2
  - irq-map : irq sub-node defining interrupt map
              (all properties listed below are required):
      - #interrupt-cells : should be 1
      - #address-cells : should be 0
      - #size-cells : should be 0
      - interrupt-map : table of entries consisting of three child elements:
          - unit_interrupt_specifier - 0 : INT1, 1 : INT2
          - interrupt parent phandle
          - parent unit interrupt specifier consisiting of two elements:
              - index of the interrupt within the controller
              - flags : should be 0

Example:

lps331ap@5d {
	compatible = "lps331ap";
	reg = <0x5d>;
	interrupt-parent = <&irq_map>;
	interrupts = <0>, <1>;

	irq_map: irq-map {
		#interrupt-cells = <1>;
		#address-cells = <0>;
		#size-cells = <0>;
		interrupt-map = <0 &gpf0 5 0>,
				<1 &gpx0 3 0>;
	};
};
```

## Documentation/devicetree/bindings/iio/light/cm36651.txt
```
* CAPELLA CM36651 I2C Proximity sensor with Color sensor

Required properties:
- compatible: must be "capella,cm36651" or "cm36651"
- reg: the I2C address of light sensor
- interrupts: interrupt to which the chip is connected
- vled-suppled: regulator for the sensor device, refere to
		Documentation/devicetree/bindings/regulator/regulator.txt

Example:

	i2c_cm36651: i2c-gpio-2 {
		/* ... */

		cm36651@18 {
			compatible = "cm36651";
			reg = <0x18>;
			interrupt-parent = <&gpx0>;
			interrupts = <2 0>;
			vled-supply = <&ps_als_reg>;
		};

		/* ... */
	};
```

## Documentation/devicetree/bindings/iio/light/gp2ap002a00f.txt
```
* Sharp GP2AP002A00F I2C Proximity/Opto sensor

Required properties:

  - compatible : should be "sharp,gp2ap002a00f"
  - reg : the I2C address of the light sensor
  - interrupt-parent : phandle to the parent interrupt controller
  - interrupts : should be INT interrupt pin
  - vled-supply : VLED power supply, as covered
		  in Documentation/devicetree/bindings/regulator/regulator.txt

Example:

gp2ap002a00f@39 {
	compatible = "sharp,gp2ap002a00f";
	reg = <0x39>;
	interrupt-parent = <&gpx0>;
	interrupts = <2 0>;
	vled-supply = <...>;
};
```
