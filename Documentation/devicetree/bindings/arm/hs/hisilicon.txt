## Documentation/devicetree/bindings/iommu/samsung,exynos4210-sysmmu.txt
```
Samsung Exynos4210 IOMMU H/W, System MMU (System Memory Management Unit)

Samsung's Exynos architecture contains System MMU that enables scattered
physical memory chunks visible as a contiguous region to DMA-capable peripheral
devices like MFC, FIMC, FIMD, GScaler, FIMC-IS and so forth.

System MMU is a sort of IOMMU and support identical translation table format to
ARMv7 translation tables with minimum set of page properties including access
permissions, shareability and security protection. In addition, System MMU has
another capabilities like L2 TLB or block-fetch buffers to minimize translation
latency.

A System MMU is dedicated to a single master peripheral device.  Thus, it is
important to specify the correct System MMU in the device node of its master
device. Whereas a System MMU is dedicated to a master device, the master device
may have more than one System MMU.

Required properties:
- compatible: Should be "samsung,exynos4210-sysmmu"
- reg: A tuple of base address and size of System MMU registers.
- interrupt-parent: The phandle of the interrupt controller of System MMU
- interrupts: A tuple of numbers that indicates the interrupt source.
- clock-names: Should be "sysmmu" if the System MMU is needed to gate its clock.
               Please refer to the following documents:
	       Documentation/devicetree/bindings/clock/clock-bindings.txt
	       Documentation/devicetree/bindings/clock/exynos4-clock.txt
	       Documentation/devicetree/bindings/clock/exynos5250-clock.txt
	       Optional "master" if the clock to the System MMU is gated by
	       another gate clock other than "sysmmu". The System MMU driver
	       sets "master" the parent of "sysmmu".
	       Exynos4 SoCs, there needs no "master" clocks.
	       Exynos5 SoCs, some System MMUs must have "master" clocks.
- clocks: Required if the System MMU is needed to gate its clock.
	  Please refer to the documents listed above.
- samsung,power-domain: Required if the System MMU is needed to gate its power.
	  Please refer to the following document:
	  Documentation/devicetree/bindings/arm/exynos/power_domain.txt

Required properties for the master peripheral devices:
- iommu: phandles to the System MMUs of the device

Examples:
A System MMU is dedicated to a single master device.
	gsc_0:  gsc@0x13e00000 {
		compatible = "samsung,exynos5-gsc";
		reg = <0x13e00000 0x1000>;
		interrupts = <0 85 0>;
		samsung,power-domain = <&pd_gsc>;
		clocks = <&clock 256>;
		clock-names = "gscl";
		iommu = <&sysmmu_gsc1>;
	};

	sysmmu_gsc0: sysmmu@13E80000 {
		compatible = "samsung,exynos4210-sysmmu";
		reg = <0x13E80000 0x1000>;
		interrupt-parent = <&combiner>;
		interrupt-names = "sysmmu-gsc0";
		interrupts = <2 0>;
		clock-names = "sysmmu", "master";
		clocks = <&clock 262>, <&clock 256>;
		samsung,power-domain = <&pd_gsc>;
		status = "ok";
	};

MFC has 2 System MMUs for each port that MFC is attached. Thus it seems natural
to define 2 System MMUs for each port of the MFC:

	mfc: codec@13400000 {
		compatible = "samsung,mfc-v5";
		reg = <0x13400000 0x10000>;
		interrupts = <0 94 0>;
		samsung,power-domain = <&pd_mfc>;
		clocks = <&clock 170>, <&clock 273>;
		clock-names = "sclk_mfc", "mfc";
		status = "ok";
		iommu = <&sysmmu_mfc_l>, <&sysmmu_mfc_r>;
	};

	sysmmu_mfc_l: sysmmu@13620000 {
		compatible = "samsung,exynos4210-sysmmu";
		reg = <0x13620000 0x1000>;
		interrupt-parent = <&combiner>;
		interrupt-names = "sysmmu-mfc-l";
		interrupts = <5 5>;
		clock-names = "sysmmu";
		clocks = <&clock 274>;
		samsung,power-domain = <&pd_mfc>;
		status = "ok";
	};

	sysmmu_mfc_r: sysmmu@13630000 {
		compatible = "samsung,exynos4210-sysmmu";
		reg = <0x13630000 0x1000>;
		interrupt-parent = <&combiner>;
		interrupt-names = "sysmmu-mfc-r";
		interrupts = <5 6>;
		clock-names = "sysmmu";
		clocks = <&clock 275>;
		samsung,power-domain = <&pd_mfc>;
		status = "ok";
	};
```

## Documentation/devicetree/bindings/media/exynos5-fimc-is.txt
```
Samsung EXYNOS5 SoC series Imaging Subsystem (FIMC-IS)
------------------------------------------------------

The camera subsystem on Samsung Exynos5 SoC has some changes relative
to previous SoC versions. Exynos5 has almost similar MIPI-CSIS and
FIMC-LITE IPs but has a much improved version of FIMC-IS which can
handle sensor controls and camera post-processing operations. The
Exynos5 FIMC-IS has a dedicated ARM Cortex A5 processor, many
post-processing blocks (ISP, DRC, FD, ODC, DIS, 3DNR) and two
dedicated scalers (SCC and SCP).

fimc-is node
------------

Required properties:

- compatible        : should contain "samsung,exynos5250-fimc-is"
- reg               : physical base address and size of the memory mapped
                      registers
- interrupts        : interrupt-specifier for the fimc-is interrupt
- clocks            : list of clock specifiers, corresponding to entries in
                      clock-names property
- clock-names       : must contain "isp", "mcu_isp", "isp_div0", "isp_div1",
                      "isp_divmpwm", "mcu_isp_div0", "mcu_isp_div1" entries,
                      matching entries in the clocks property
- samsung,pmu       : phandle to the Power Management Unit (PMU) node

i2c-isp (ISP I2C bus controller) nodes
--------------------------------------
The i2c-isp nodes should be children of the fimc-is node.

Required properties:

- compatible	: must contain "samsung,exynos4212-i2c-isp" for Exynos4212,
		  Exynos4412 and Exynos5250 SoCs
- reg		: physical base address and length of the registers set
- clocks	: should contain gate clock specifier for this controller
- clock-names	: should contain "i2c_isp" for the gate clock
- pinctrl-0	: phandle of the pinctrl node for the i2c isp
- pinctrl-names : must contain "default"

ranges, #address-cells, and #size-cells should be present as appropriate.

Device tree nodes of the image sensors controlled directly by the FIMC-IS
firmware must be child nodes of their corresponding ISP I2C bus controller node.
The data link of these image sensors must be specified using the common video
interfaces bindings, defined in video-interfaces.txt.

Example:

	fimc_is: fimc-is@13000000 {
		compatible = "samsung,exynos5250-fimc-is";
		#address-cells = <1>;
		#size-cells = <1>;
		ranges;
		reg = <0x13000000 0x200000>;
		interrupt-parent = <&combiner>;
		interrupts = <19 1>;
		clocks = <&clock 346>, <&clock 347>, <&clock 512>,
			<&clock 513>, <&clock 514>, <&clock 515>,
			<&clock 516>;
		clock-names = "isp", "mcu_isp", "isp_div0", "isp_div1",
				"isp_divmpwm", "mcu_isp_div0",
				"mcu_isp_div1";
		samsung,pmu = <&pmu>;

		i2c0_isp: i2c-isp@13130000 {
			compatible = "samsung,exynos4212-i2c-isp";
			reg = <0x13130000 0x100>;
			#address-cells = <1>;
			#size-cells = <0>;
			clocks = <&clock 352>;
			clock-names = "i2c_isp";
			pinctrl-0 = <&cam_i2c0_bus>;
			pinctrl-names = "default";
		};

		i2c1_isp: i2c-isp@13140000 {
			compatible = "samsung,exynos4212-i2c-isp";
			reg = <0x13140000 0x100>;
			#address-cells = <1>;
			#size-cells = <0>;
			clocks = <&clock 353>;
			clock-names = "i2c_isp";
			pinctrl-0 = <&cam_i2c1_bus>;
			pinctrl-names = "default";
		};
	};

In the board specific file the sensor nodes can be provided. For the sensor
node documentation for s5k4e5, please refer to samsung-s5k4e5.txt

	fimc-is@13000000 {
		status = "okay";

		i2c-isp@13130000 {
			s5k4e5@20 {
				compatible = "samsung,s5k4e5";
				reg = <0x20>;
				reset-gpios = <&gpx1 2 1>;
				clock-frequency = <24000000>;
				clocks = <&clock 129>;
				clock-names = "extclk";
				svdda-supply = <&vdd>;
				svddio-supply = <&vdd>;
				port {
					is_s5k4e5_ep: endpoint {
						remote-endpoint = <&csis0_ep>;
					};
				};
			};
		};
	};
```

## Documentation/devicetree/bindings/media/exynos5250-camera.txt
```
Samsung EXYNOS5 SoC Camera Subsystem
------------------------------------

The Exynos5 SoC Camera subsystem comprises of multiple sub-devices
represented by separate device tree nodes. Currently this includes: FIMC-LITE,
MIPI CSIS and FIMC-IS.

The sub-device nodes are referenced using phandles in the common 'camera' node
which also includes common properties of the whole subsystem not really
specific to any single sub-device, like common camera port pins or the common
camera bus clocks.

Common 'camera' node
--------------------

Required properties:

- compatible		: must be "samsung,exynos5250-fimc"
- clocks		: list of clock specifiers, corresponding to entries in
                          the clock-names property
- clock-names		: must contain "sclk_bayer" entry
- samsung,csis		: list of phandles to the mipi-csis device nodes
- samsung,fimc-lite	: list of phandles to the fimc-lite device nodes
- samsung,fimc-is	: phandle to the fimc-is device node

The pinctrl bindings defined in ../pinctrl/pinctrl-bindings.txt must be used
to define a required pinctrl state named "default".

'parallel-ports' node
---------------------

This node should contain child 'port' nodes specifying active parallel video
input ports. It includes camera A, camera B and RGB bay inputs.
'reg' property in the port nodes specifies the input type:
 1 - parallel camport A
 2 - parallel camport B
 5 - RGB camera bay

3, 4 are for MIPI CSI-2 bus and are already described in samsung-mipi-csis.txt

Image sensor nodes
------------------

The sensor device nodes should be added to their control bus controller (e.g.
I2C0) nodes and linked to a port node in the csis or the parallel-ports node,
using the common video interfaces bindings, defined in video-interfaces.txt.

Example:

	aliases {
		fimc-lite0 = &fimc_lite_0
	};

	/* Parallel bus IF sensor */
	i2c_0: i2c@13860000 {
		s5k6aa: sensor@3c {
			compatible = "samsung,s5k6aafx";
			reg = <0x3c>;
			vddio-supply = <...>;

			clock-frequency = <24000000>;
			clocks = <...>;
			clock-names = "mclk";

			port {
				s5k6aa_ep: endpoint {
					remote-endpoint = <&fimc0_ep>;
					bus-width = <8>;
					hsync-active = <0>;
					vsync-active = <1>;
					pclk-sample = <1>;
				};
			};
		};
	};

	/* MIPI CSI-2 bus IF sensor */
	s5c73m3: sensor@1a {
		compatible = "samsung,s5c73m3";
		reg = <0x1a>;
		vddio-supply = <...>;

		clock-frequency = <24000000>;
		clocks = <...>;
		clock-names = "mclk";

		port {
			s5c73m3_1: endpoint {
				data-lanes = <1 2 3 4>;
				remote-endpoint = <&csis0_ep>;
			};
		};
	};

	camera {
		compatible = "samsung,exynos5250-fimc";
		#address-cells = <1>;
		#size-cells = <1>;
		status = "okay";

		pinctrl-names = "default";
		pinctrl-0 = <&cam_port_a_clk_active>;

		samsung,csis = <&csis_0>, <&csis_1>;
		samsung,fimc-lite = <&fimc_lite_0>, <&fimc_lite_1>, <&fimc_lite_2>;
		samsung,fimc-is = <&fimc_is>;

		/* parallel camera ports */
		parallel-ports {
			/* camera A input */
			port@1 {
				reg = <1>;
				camport_a_ep: endpoint {
					remote-endpoint = <&s5k6aa_ep>;
					bus-width = <8>;
					hsync-active = <0>;
					vsync-active = <1>;
					pclk-sample = <1>;
				};
			};
		};
	};

MIPI-CSIS device binding is defined in samsung-mipi-csis.txt, FIMC-LITE
device binding is defined in exynos-fimc-lite.txt and FIMC-IS binding
is defined in exynos5-fimc-is.txt.
```

## Documentation/devicetree/bindings/media/samsung-s5k5baf.txt
```
Samsung S5K5BAF UXGA 1/5" 2M CMOS Image Sensor with embedded SoC ISP
--------------------------------------------------------------------

Required properties:

- compatible	  : "samsung,s5k5baf";
- reg		  : I2C slave address of the sensor;
- vdda-supply	  : analog power supply 2.8V (2.6V to 3.0V);
- vddreg-supply	  : regulator input power supply 1.8V (1.7V to 1.9V)
		    or 2.8V (2.6V to 3.0);
- vddio-supply	  : I/O power supply 1.8V (1.65V to 1.95V)
		    or 2.8V (2.5V to 3.1V);
- stbyn-gpios	  : GPIO connected to STBYN pin;
- rstn-gpios	  : GPIO connected to RSTN pin;
- clocks	  : the sensor's master clock specifier (from the common
		    clock bindings);
- clock-names	  : must be "mclk";

Optional properties:

- clock-frequency : the frequency at which the "mclk" clock should be
		    configured to operate, in Hz; if this property is not
		    specified default 24 MHz value will be used.

The device node should contain one 'port' child node with one child 'endpoint'
node, according to the bindings defined in Documentation/devicetree/bindings/
media/video-interfaces.txt. The following are properties specific to those
nodes.

endpoint node
-------------

- data-lanes : (optional) specifies MIPI CSI-2 data lanes as covered in
  video-interfaces.txt. This sensor doesn't support data lane remapping
  and physical lane indexes in subsequent elements of the array should
  have consecutive values.

Example:

s5k5bafx@2d {
	compatible = "samsung,s5k5baf";
	reg = <0x2d>;
	vdda-supply = <&cam_io_en_reg>;
	vddreg-supply = <&vt_core_15v_reg>;
	vddio-supply = <&vtcam_reg>;
	stbyn-gpios = <&gpl2 0 1>;
	rstn-gpios = <&gpl2 1 1>;
	clock-names = "mclk";
	clocks = <&clock_cam 0>;
	clock-frequency = <24000000>;

	port {
		s5k5bafx_ep: endpoint {
			remote-endpoint = <&csis1_ep>;
			data-lanes = <1>;
		};
	};
};
```

## Documentation/devicetree/bindings/media/samsung-s5k8b1.txt
```
Samsung S5K8B1YX raw image sensor
---------------------------------

S5K8B1YX is a raw image sensor with MIPI CSI-2 image data interfaces and CCI
(I2C compatible) control bus.

Required properties:

- compatible	  : "samsung,s5k8b1";
- reg		  : I2C slave address of the sensor;
- vdda-supply	  : analogue power supply (typically 2.8 V);
- vddio-supply	  : digital I/O power supply (typically 1.8 V);
- vddd-supply	  : digital core power supply (typically 1.2 V);
- xshutdown-gpios : specifier of a GPIO connected to the XSHUTDOWN pin;
- clocks	  : should contain the sensor's EXTCLK clock specifier, from
		    the common clock bindings.
- clock-names	  : should contain "extclk" entry;
- data-lanes	  : specifies MIPI CSI-2 data lanes as covered in
		    video-interfaces.txt. The sensor supports up to 2 data
		    lanes.

Optional properties:

- clock-frequency : the frequency at which the "extclk" clock should be
		    configured to operate, in Hz; if this property is not
		    specified default 24 MHz value will be used.

The common video interfaces bindings (see video-interfaces.txt) should be
used to specify link to the image data receiver. The S5K8B1YX device node
should contain one 'port' child node with an 'endpoint' subnode.
```
