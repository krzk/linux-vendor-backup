## Documentation/devicetree/bindings/thermal/exynos-thermal.txt
```
* Exynos Thermal Management Unit (TMU)

** Required properties:

- compatible : One of the following:
	       "samsung,exynos3250-tmu"
	       "samsung,exynos4412-tmu"
	       "samsung,exynos4210-tmu"
	       "samsung,exynos5250-tmu"
- interrupt-parent : The phandle for the interrupt controller
- reg : Address range of the thermal registers
- interrupts : Should contain interrupt for thermal system
- clocks : The main clock for TMU device
- clock-names : Thermal system clock name

Example:

	tmu@100C0000 {
		compatible = "samsung,exynos4412-tmu";
		interrupt-parent = <&combiner>;
		reg = <0x100C0000 0x100>;
		interrupts = <2 4>;
		clocks = <&clock 383>;
		clock-names = "tmu_apbif";
		status = "disabled";
	};
```

## Documentation/devicetree/bindings/video/exynos_hdmi.txt
```
Device-Tree bindings for drm hdmi driver

Required properties:
- compatible: value should be one among the following:
	1) "samsung,exynos5-hdmi" <DEPRECATED>
	2) "samsung,exynos4210-hdmi"
	3) "samsung,exynos4212-hdmi"
	4) "samsung,exynos5420-hdmi"
	5) "samsung,exynos5430-hdmi"
- reg: physical base address of the hdmi and length of memory mapped
	region.
- interrupts: interrupt number to the cpu.
- hpd-gpio: following information about the hotplug gpio pin.
	a) phandle of the gpio controller node.
	b) pin number within the gpio controller.
	c) optional flags and pull up/down.
- clocks: list of clock specifiers for the clocks described in clock-names.
- clock-names: names of clocks used by device, varies per compatible string:
	Exynos 4210, 4212, 5420:
		hdmi, sclk_hdmi, sclk_pixel, sclk_hdmiphy, mout_hdmi,
	Exynos 5430:
		hdmi_pclk, hdmi_i_pclk, i_tmds_clk, i_pixel_clk, oscclk,
		tmds_clko, tmds_clko_user, pixel_clko, pixel_clko_user
- ddc: phandle to the hdmi ddc node
- phy: phandle to the hdmi phy node
- samsung,syscon-phandle: phandle for system controller node for PMU.

Required for Exynos 5430:
- samsung,sysreg-phandle: phandle for system controller node for SYSREG block.

Example:

	hdmi {
		compatible = "samsung,exynos4212-hdmi";
		reg = <0x14530000 0x100000>;
		interrupts = <0 95 0>;
		hpd-gpio = <&gpx3 7 1>;
		ddc = <&hdmi_ddc_node>;
		phy = <&hdmi_phy_node>;
		samsung,syscon-phandle = <&pmu_system_controller>;
	};
```
