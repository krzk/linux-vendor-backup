## arch/arm/mach-omap2/Kconfig
```kconfig
comment "OMAP Core Type"
	depends on ARCH_OMAP2

config ARCH_OMAP24XX
	bool "OMAP24xx Based System"
	depends on ARCH_OMAP2

config ARCH_OMAP2420
	bool "OMAP2420 support"
	depends on ARCH_OMAP24XX
	select OMAP_DM_TIMER
	select ARCH_OMAP_OTG

config ARCH_OMAP2430
	bool "OMAP2430 support"
	depends on ARCH_OMAP24XX

config ARCH_OMAP34XX
	bool "OMAP34xx Based System"
	depends on ARCH_OMAP3
	select USB_ARCH_HAS_EHCI

config ARCH_OMAP3430
	bool "OMAP3430 support"
	depends on ARCH_OMAP3 && ARCH_OMAP34XX
	select ARCH_OMAP_OTG

config OMAP_PACKAGE_CBC
       bool

config OMAP_PACKAGE_CBB
       bool

config OMAP_PACKAGE_CUS
       bool

config OMAP_PACKAGE_CBP
       bool

comment "OMAP Board Type"
	depends on ARCH_OMAP2 || ARCH_OMAP3 || ARCH_OMAP4

config MACH_OMAP_GENERIC
	bool "Generic OMAP board"
	depends on ARCH_OMAP2 && ARCH_OMAP24XX

config MACH_OMAP2_TUSB6010
	bool
	depends on ARCH_OMAP2 && ARCH_OMAP2420
	default y if MACH_NOKIA_N8X0

config MACH_OMAP_H4
	bool "OMAP 2420 H4 board"
	depends on ARCH_OMAP2 && ARCH_OMAP24XX
	select OMAP_DEBUG_DEVICES

config MACH_OMAP_APOLLON
	bool "OMAP 2420 Apollon board"
	depends on ARCH_OMAP2 && ARCH_OMAP24XX

config MACH_OMAP_2430SDP
	bool "OMAP 2430 SDP board"
	depends on ARCH_OMAP2 && ARCH_OMAP24XX

config MACH_OMAP3_BEAGLE
	bool "OMAP3 BEAGLE board"
	depends on ARCH_OMAP3 && ARCH_OMAP34XX
	select OMAP_PACKAGE_CBB

config MACH_OMAP_LDP
	bool "OMAP3 LDP board"
	depends on ARCH_OMAP3 && ARCH_OMAP34XX
	select OMAP_PACKAGE_CBB

config MACH_OVERO
	bool "Gumstix Overo board"
	depends on ARCH_OMAP3 && ARCH_OMAP34XX
	select OMAP_PACKAGE_CBB

config MACH_OMAP3EVM
	bool "OMAP 3530 EVM board"
	depends on ARCH_OMAP3 && ARCH_OMAP34XX

config MACH_OMAP3517EVM
	bool "OMAP3517/ AM3517 EVM board"
	depends on ARCH_OMAP3 && ARCH_OMAP34XX
	select OMAP_PACKAGE_CBB

config MACH_OMAP3_PANDORA
	bool "OMAP3 Pandora"
	depends on ARCH_OMAP3 && ARCH_OMAP34XX
	select OMAP_PACKAGE_CBB

config L2CACHE_OMAP3_DISABLE
	bool "Disable level 2 cache in Aux cntrl reg"
	depends on ARCH_OMAP3
	help
		Say Y here to disable L2 cache.

config WIFI_CONTROL_FUNC
        bool "Enable WiFi control function abstraction"
	depends on MACH_OMAP_ZOOM2 || MACH_SHOLES || MACH_OMAP_4430SDP || MACH_OMAP_ZOOM3 || MACH_OMAP_SAMSUNG
        help
          Enables Power/Reset/Carddetect function abstraction

config TIWLAN_SDIO
	bool "TI WLAN Enhanced SDIO Contoller support"
	depends on MMC_OMAP || MMC_OMAP_MODULE || MMC_OMAP_HS || MMC_OMAP_HS_MODULE
	help
	   Say Y here if you want to be able to use TI's WLAN device using the
	   SDIO interface. If unsure, say N.

config TIWLAN_MMC_CONTROLLER
	int "MMC Controller number that TI WLAN chip is connected to"
	range 1 5
	depends on TIWLAN_SDIO || MMC_EMBEDDED_SDIO
	help
	  Choose the number of the MMC controller that TI WLAN chip is
	  connected to. TI WLAN has SDIO host controller that will control
	  this MMC port.

config MACH_OMAP_3430SDP
	bool "OMAP 3430 SDP board"
	depends on ARCH_OMAP3 && ARCH_OMAP34XX
	select OMAP_PACKAGE_CBB

config MACH_NOKIA_N800
       bool

config MACH_NOKIA_N810
       bool

config MACH_NOKIA_N810_WIMAX
       bool

config MACH_NOKIA_N8X0
	bool "Nokia N800/N810"
	depends on ARCH_OMAP2420
	select MACH_NOKIA_N800
	select MACH_NOKIA_N810
	select MACH_NOKIA_N810_WIMAX

config MACH_NOKIA_RX51
	bool "Nokia RX-51 board"
	depends on ARCH_OMAP3 && ARCH_OMAP34XX
	select OMAP_PACKAGE_CBB

config MACH_OMAP_ZOOM2
	bool "OMAP3 Zoom2 board"
	depends on ARCH_OMAP3 && ARCH_OMAP34XX
	select OMAP_PACKAGE_CBB

config MACH_OMAP_ZOOM3
	bool "OMAP3630 Zoom3 board"
        depends on ARCH_OMAP3 && ARCH_OMAP34XX
        select OMAP_PACKAGE_CBP

config MACH_SHOLES
	bool "Motorola sholes"
	depends on ARCH_OMAP3 && ARCH_OMAP34XX
	select OMAP_PACKAGE_CBP

config MACH_SHOLES_UMTS
	bool "Motorola sholes umts"
	depends on MACH_SHOLES

config MACH_CM_T35
	bool "CompuLab CM-T35 module"
	depends on ARCH_OMAP3 && ARCH_OMAP34XX
	select OMAP_PACKAGE_CUS

config MACH_IGEP0020
	bool "IGEP0020"
	depends on ARCH_OMAP3 && ARCH_OMAP34XX
	select OMAP_PACKAGE_CBB

config MACH_OMAP_3630SDP
	bool "OMAP3630 SDP board"
	depends on ARCH_OMAP3 && ARCH_OMAP34XX
	select OMAP_PACKAGE_CBP

config MACH_OMAP_4430SDP
	bool "OMAP 4430 SDP board"
	depends on ARCH_OMAP4

config ERRATA_OMAP4_AXI2OCP
	bool "OMAP 4430 axi2ocp errata workaround"
	depends on ARCH_OMAP4
	help
	Pending response counter logic is incorrectly implemented
	It decrements by only 1 even when there are 2+ responses in the
	same cycle. If 2 MCMDs send out bridge at the same time counter
	increments by.1 but when it decrement for 2 responses counter does
	not go beyond 0.
	Work-around:
	Any new request before timer max out resets the timer. With this hang
	issue will not happen.

config OMAP3_EMU
	bool "OMAP3 debugging peripherals"
	depends on ARCH_OMAP3
	select OC_ETM
	help
	  Say Y here to enable debugging hardware of omap3

config OMAP3_SDRC_AC_TIMING
	bool "Enable SDRC AC timing register changes"
	depends on ARCH_OMAP3 && ARCH_OMAP34XX
	default n
	help
	  If you know that none of your system initiators will attempt to
	  access SDRAM during CORE DVFS, select Y here.  This should boost
	  SDRAM performance at lower CORE OPPs.  There are relatively few
	  users who will wish to say yes at this point - almost everyone will
	  wish to say no.  Selecting yes without understanding what is
	  going on could result in system crashes;

comment "OMAP based Samsung Board Type"
	depends on ARCH_OMAP2 || ARCH_OMAP3 || ARCH_OMAP4

config MACH_OMAP_SAMSUNG
	bool "OMAP based Samsung Board"
	depends on ARCH_OMAP3 && ARCH_OMAP34XX
	select OMAP_PACKAGE_CBP
	default n

config MACH_SAMSUNG_LATONA
	bool "Samsung Latona (GT-I9003) Board"
	default n
	select MACH_OMAP_SAMSUNG

config CHN_MACH_HERON
	bool "Samsung Heron (GT-I9003) Board"
	default n
	select MACH_OMAP_SAMSUNG
	
config MACH_SAMSUNG_HERON
	bool "Samsung Heron (GT-S5820) Board"
	default n
	select MACH_OMAP_SAMSUNG

menu "OMAP Samsung Specific Cofigurations"
	depends on MACH_OMAP_SAMSUNG

config SAMSUNG_MODEL_NAME
        string "Samsung Model Name"
        depends on MACH_OMAP_SAMSUNG
        default ""

choice
	prompt "Samsung HW Board-Type"
	default SAMSUNG_HW_EMU_BOARD

config SAMSUNG_HW_EMU_BOARD
	bool "Samsung HW EMUL-Board"
	default y

config SAMSUNG_HW_REL_BOARD
	bool "Samsung HW REAL-Board"
	default n
	
endchoice

config SAMSUNG_EMU_HW_REV
	int "Samsung EMUL HW Revision"
	depends on MACH_OMAP_SAMSUNG && SAMSUNG_HW_EMU_BOARD
	default 0

config SAMSUNG_REL_HW_REV
	int "Samsung REAL HW Revision"
	depends on MACH_OMAP_SAMSUNG && SAMSUNG_HW_REL_BOARD
	default 0

config SAMSUNG_KERNEL_DEBUG
        bool "Samsung Kernel Debuging Code"
        depends on MACH_OMAP_SAMSUNG
        default n

config SAMSUNG_KERNEL_DEBUG_USER
	bool "Forced crash by key combination"
	depends on MACH_OMAP_SAMSUNG
	default n

config SAMSUNG_USE_GETLOG
	bool "Samsung getLog Debuging Feature"
	depends on MACH_OMAP_SAMSUNG
	default n
	help
		Add a MARK string to the kernel log message indicating
		starting addresses of 'FrameBuffer / printk Log buffer /
		Platform log buffer. This feature is used to extract
		debuggin information from log messages.

config SAMSUNG_ADD_GAFORENSICINFO
	bool "Samsung GAF Debuging Feature"
	depends on MACH_OMAP_SAMSUNG
	default n
	help
		Add additional information to the ram dump. This information
		will be analized in GAF Tool.

config SAMSUNG_PASS_PLATFORM_LOG_TO_KERNEL
	bool "Samsung Pass Platform Log to Kernel"
	depends on MACH_OMAP_SAMSUNG
	default n
	help
		This feature make a log message which is started with !@ is
		displaye through printk function.

config SAMSUNG_USE_SEC_LOG_BUF
	bool "Samsung Use SEC_LOG_BUF"
	depends on MACH_OMAP_SAMSUNG
	default n
	help
		This feature stores all serial log messages into the
		SEC_LOG_BUF area.
config CHN_CP_PNX
	bool "China CP Chip PNX"
	depends on MACH_OMAP_SAMSUNG
	default n
	help
		PNX6718

config CHN_ONEDRAM
	bool "China Model Onedram"
	depends on MACH_OMAP_SAMSUNG
	default n
	help
		LatonaTD Onedram

config CHN_KERNEL_CPNAND
	bool "China Kernel configuration for TD "
	default n
	depends on MACH_OMAP_SAMSUNG

config CHN_KENEL_LATONA_TEMP
	bool "China Kernel configuration for TD temporary"
	default n
	depends on MACH_OMAP_SAMSUNG

endmenu

config CHN_KERNEL_STE_LATONA
	bool "China Kernel configuration for TD "
	default n
	depends on MACH_OMAP_SAMSUNG	
	
config MACH_TD_ALARM
	bool "Kernel alarm booting configuration for TD "
	default n
	depends on MACH_OMAP_SAMSUNG	
```

## arch/arm64/boot/tizen-tm2.its
```
/dts-v1/;
/ {
	description = "Combined kernel and dtbs image for Tizen TM2 board";
	#address-cells = <1>;
	images {
		kernel@0 {
			description = "Linux kernel for arm64 exynos5433";
			data = /incbin/("Image.gz");
			type = "kernel";
			arch = "arm64";
			os = "linux";
			compression = "gzip";
			load = <0x20080000>;
			entry = <0x20080000>;
			hash@1 {
				algo = "crc32";
			};
		};
		fdt@0 {
			description = "exynos5433-tm2.dtb";
			data = /incbin/("dts/exynos/exynos5433-tm2.dtb");
			type = "flat_dt";
			arch = "arm64";
			compression = "none";
			load = <0x24000000>;
			hash@1 {
				algo = "crc32";
			};
		};
		fdt@1 {
			description = "exynos5433-tm2e.dtb";
			data = /incbin/("dts/exynos/exynos5433-tm2e.dtb");
			type = "flat_dt";
			arch = "arm64";
			compression = "none";
			load = <0x24000000>;
			hash@1 {
				algo = "crc32";
			};
		};
	};
	configurations {
		default = "tm2@0";
		tm2@0 {
			description = "Linux kernel with exynos5433-tm2.dtb";
			kernel = "kernel@0";
			fdt = "fdt@0";
		};
		tm2e@1 {
			description = "Linux kernel with exynos5433-tm2e.dtb";
			kernel = "kernel@0";
			fdt = "fdt@1";
		};
	};
};
```

## arch/arm64/configs/tizen_galileo_large_lte_defconfig
```kconfig
CONFIG_GALILEO_LARGE=y
CONFIG_GALILEO_LTE=y
CONFIG_MCU_IPC=y
CONFIG_SHM_IPC=y
CONFIG_SEC_SIPC_MODEM_IF=y
CONFIG_EXYNOS_DECON_LCD_S6E36W3X01_L=y
```

## arch/arm64/configs/tizen_solis_lte_na_tmo_defconfig
```kconfig
CONFIG_SOLIS_LTE=y
CONFIG_SOLIS_LTE_NA_TMO=y
CONFIG_USB_SLP_RNDIS_SUPPORT=y
CONFIG_CP_SECURE_BOOT_RESET=y
```
